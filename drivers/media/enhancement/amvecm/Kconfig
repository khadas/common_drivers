## drivers/media/enhancement/amvecm/Kconfig
```kconfig
# SPDX-License-Identifier: (GPL-2.0+ OR MIT)
#
# AMLOGIC amvecm devices configuration
#

comment "Amlogic VECM Drivers"

menu "Amlogic amvecm Driver"

config AMLOGIC_MEDIA_ENHANCEMENT_VECM
        bool "Amlogic amvecm driver"
        default n
        help
            Amlogic amvecm module init
            select to enable amlogic pq driver
endmenu
```

## drivers/media/esm/Kconfig
```kconfig
# SPDX-License-Identifier: (GPL-2.0+ OR MIT)
#
# AMLOGIC_ESM
#

menu "ESM Support"

config AMLOGIC_ESM
	bool "Embedded Security Module Enable"
	depends on AMLOGIC_HDMITX || TVIN_HDMI
	help
		Embedded Security Module(ESM) for HDCP22

endmenu
```

## drivers/media/frame_sync/Kconfig
```kconfig
# SPDX-License-Identifier: (GPL-2.0+ OR MIT)
#
# frame sync configuration
#

config AMLOGIC_MEDIA_FRAME_SYNC
        bool "Amlogic frame sync Support"
        default n
        help
                Select to enable frame sync support
```

## drivers/media/frc/Kconfig
```kconfig
# SPDX-License-Identifier: (GPL-2.0+ OR MIT)
#
# frame sync configuration
#

config AMLOGIC_MEDIA_FRC
        bool "Amlogic FRC Support"
        default n
        help
                Select to enable frc support
```

## drivers/media/gdc/Kconfig
```kconfig
# SPDX-License-Identifier: (GPL-2.0+ OR MIT)
#
# gdc driver configuration
#
config AMLOGIC_MEDIA_GDC
	tristate "Amlogic gdc driver"
	default n
	help
		Select to enable gdc driver.
```

## drivers/media/video_processor/Kconfig
```kconfig
# SPDX-License-Identifier: (GPL-2.0+ OR MIT)
#
# Amlogic video processor configuration
#

menu "Amlogic Video Processor Support"

config AMLOGIC_MEDIA_VIDEO_PROCESSOR
	bool "Amlogic Video Processor Driver"
	default n
	help
		Amlogic Video Processor module support,
		such as ION_VIDEO, PPMGR, AML_V4L_VIDEO and etc,
		both of which depends on this
		configuration options.

if AMLOGIC_MEDIA_VIDEO_PROCESSOR
source "$(COMMON_DRIVERS_DIR)/drivers/media/video_processor/pic_dev/Kconfig"

source "$(COMMON_DRIVERS_DIR)/drivers/media/video_processor/ppmgr/Kconfig"
source "$(COMMON_DRIVERS_DIR)/drivers/media/video_processor/utils/Kconfig"
source "$(COMMON_DRIVERS_DIR)/drivers/media/video_processor/videosync/Kconfig"
# source "$(COMMON_DRIVERS_DIR)/drivers/media/video_processor/pic_dev/Kconfig"
source "$(COMMON_DRIVERS_DIR)/drivers/media/video_processor/video_dev/Kconfig"
source "$(COMMON_DRIVERS_DIR)/drivers/media/video_processor/ionvideo/Kconfig"
source "$(COMMON_DRIVERS_DIR)/drivers/media/video_processor/v4lvideo/Kconfig"
source "$(COMMON_DRIVERS_DIR)/drivers/media/video_processor/video_composer/Kconfig"
source "$(COMMON_DRIVERS_DIR)/drivers/media/video_processor/videotunnel/Kconfig"
source "$(COMMON_DRIVERS_DIR)/drivers/media/video_processor/vdetect/Kconfig"
source "$(COMMON_DRIVERS_DIR)/drivers/media/video_processor/videoqueue/Kconfig"
source "$(COMMON_DRIVERS_DIR)/drivers/media/video_processor/common/Kconfig"
endif

endmenu
```

## drivers/media/video_processor/common/Kconfig
```kconfig
# SPDX-License-Identifier: (GPL-2.0+ OR MIT)

#
# Amlogic video_pp_common device configuration
#

menu "Amlogic video_pp_common support"

config AMLOGIC_VIDEO_PP_COMMON
	tristate "Amlogic video_pp_common device support"
	depends on VIDEO_DEV
	default n

	help
		Select to enable "Amlogic video_pp_common device support.

endmenu
```

## drivers/media/video_processor/pic_dev/Kconfig
```kconfig
# SPDX-License-Identifier: (GPL-2.0+ OR MIT)
#
# Amlogic picture decoder device configuration
#

menu "Amlogic picture decoder support"

config AMLOGIC_PIC_DEC
		tristate "Amlogic picture decoder"
		default n
		help
			This option is used to configure Amlogic driver
			for picture decoder.
			Select to enable picture decoder.
			Disable by default.

endmenu
```

## drivers/media/video_processor/video_composer/Kconfig
```kconfig
# SPDX-License-Identifier: (GPL-2.0+ OR MIT)

#
# Amlogic video_composer device configuration
#

menu "Amlogic video_composer support"

config AMLOGIC_VIDEO_COMPOSER
	tristate "Amlogic video_composer device support"
#	depends on VIDEO_DEV
	default n

	help
		Select to enable "Amlogic video_composer device support.

endmenu
```

## drivers/media/video_processor/videosync/Kconfig
```kconfig
# SPDX-License-Identifier: (GPL-2.0+ OR MIT)

menu "Amlogic videosync support"

config AMLOGIC_VIDEOSYNC
	tristate "amlogic videosync device support"
	depends on VIDEO_DEV
	default n

	help
		This module provides Amlogic videosync support
		select to enable video sync to player
		enabled by default
		good luck

endmenu
```

## drivers/media/vin/adc/Kconfig
```kconfig
# SPDX-License-Identifier: (GPL-2.0+ OR MIT)
#
# ADC Device Driver Configuration
#
config AMLOGIC_MEDIA_ADC
        tristate "Amlogic ADC device driver"
        default n
        help
            ADC device driver.
```

## drivers/media/vin/tvin/Kconfig
```kconfig
# SPDX-License-Identifier: (GPL-2.0+ OR MIT)
#
# Amlogic tvin drivers configuration
#

comment "Tvin drivers"

config AMLOGIC_MEDIA_TVIN
        bool "Amlogic drivers of the media tvin"
	depends on AMLOGIC_MEDIA_VIN
	default n
	help
		This option is used to configure Amlogic drivers
		of the multimedia input of tvin, which consists
		of tvafe module, viu module, vdin module and
		hdmirx module.

if AMLOGIC_MEDIA_TVIN
source "$(COMMON_DRIVERS_DIR)/drivers/media/vin/tvin/vdin/Kconfig"
source "$(COMMON_DRIVERS_DIR)/drivers/media/vin/tvin/tvafe/Kconfig"
source "$(COMMON_DRIVERS_DIR)/drivers/media/vin/tvin/viu/Kconfig"
source "$(COMMON_DRIVERS_DIR)/drivers/media/vin/tvin/bt656/Kconfig"
source "$(COMMON_DRIVERS_DIR)/drivers/media/vin/tvin/hdmirx/Kconfig"
endif

config AMLOGIC_TVIN_USE_DEBUG_FILE
        tristate "Enable vdin debug file"
        depends on AMLOGIC_DEBUG_FILE
        default y
        help
            Debug file for vdin write buffer
```

## drivers/media/vin/tvin/dsc_dec/Kconfig
```kconfig
# SPDX-License-Identifier: (GPL-2.0+ OR MIT)
#
# HDMI Rx Device Driver Configuration
#


config AMLOGIC_MEDIA_TVIN_DSC_DEC
    tristate "Amlogic DSC DEC device driver"
    default n
    help
      DSC DEC device driver.
```

## drivers/media/vin/tvin/vdin/Kconfig
```kconfig
# SPDX-License-Identifier: (GPL-2.0+ OR MIT)
#
# VDIN Device Driver Configuration
#

config AMLOGIC_MEDIA_VDIN
        tristate "Amlogic Vdin device driver"
        default n
        help
            Vdin device driver.
```

## drivers/media/vout/Kconfig
```kconfig
# SPDX-License-Identifier: (GPL-2.0+ OR MIT)
#
# Amlogic vout driver configuration
#

menu "Amlogic Vout Driver Support"

config AMLOGIC_VOUT
	bool "Amlogic Vout Driver"
	default n
	help
		Amlogic Video output module support.
		Vout module includes HDMI-TX, CVBS, PANEL(LCD, backlight) etc.
		Also provide display mode service for all the display modules.
		Amlogic Video output module support.
		Vout module includes HDMI-TX, CVBS, PANEL(LCD, backlight) etc.
		Also provide display mode service for all the display modules.

if AMLOGIC_VOUT
source "$(COMMON_DRIVERS_DIR)/drivers/media/vout/vclk_serve/Kconfig"
source "$(COMMON_DRIVERS_DIR)/drivers/media/vout/vout_serve/Kconfig"
source "$(COMMON_DRIVERS_DIR)/drivers/media/vout/lcd/Kconfig"
source "$(COMMON_DRIVERS_DIR)/drivers/media/vout/hdmitx_common/Kconfig"
source "$(COMMON_DRIVERS_DIR)/drivers/media/vout/peripheral_lcd/Kconfig"
source "$(COMMON_DRIVERS_DIR)/drivers/media/vout/hdmitx21/Kconfig"
source "$(COMMON_DRIVERS_DIR)/drivers/media/vout/hdmitx/Kconfig"
source "$(COMMON_DRIVERS_DIR)/drivers/media/vout/cvbs/Kconfig"
source "$(COMMON_DRIVERS_DIR)/drivers/media/vout/vdac/Kconfig"
endif

endmenu
```

## drivers/media/vout/hdmitx20/Kconfig
```kconfig
# SPDX-License-Identifier: (GPL-2.0+ OR MIT)

#
# HDMITX
#
menu "Amlogic HDMITX Module"

config AMLOGIC_HDMITX
	bool "AMLOGIC HDMITX driver"
	select AMLOGIC_HDMITX_COMMON
	default n
	help
	This option is used to configure Amlogic drivers
        of the hdmi tx output

endmenu
```

## drivers/media/vout/hdmitx21/Kconfig
```kconfig
# SPDX-License-Identifier: (GPL-2.0+ OR MIT)

#
# HDMITX
#
menu "Amlogic HDMITX Module"

config AMLOGIC_HDMITX21
	bool "AMLOGIC HDMITX21 driver"
	default n
	select HDMI
	select AMLOGIC_HDMITX_COMMON
	help
	This option is used to configure Amlogic drivers
        of the hdmi tx output

endmenu
```

## drivers/media/vout/hdmitx_common/Kconfig
```kconfig
# SPDX-License-Identifier: (GPL-2.0+ OR MIT)

#
# HDMITX Common
#
menu "Amlogic HDMITX Common Module"

config AMLOGIC_HDMITX_COMMON
	bool "AMLOGIC HDMITX common"
	default n
	help
	This option is used to configure Amlogic drivers
        of the hdmi tx common software part

endmenu
```

## drivers/media/vout/lcd/Kconfig
```kconfig
# SPDX-License-Identifier: (GPL-2.0+ OR MIT)

#
# Video output configuration
#
menu "Amlogic LCD Output Module"

config AMLOGIC_LCD
	bool "LCD Output Module"
	default n
	help
		LCD output module
		support tv mode and tablet mode
		Through the inside of the DTS file "mode" is
		to choose a TV mode or tablet mode

config AMLOGIC_LCD_TV
	bool "LCD TV Output Module"
	default n
	depends on AMLOGIC_LCD
	help
		LCD TV output module
		Configure the LCD output model for TV output
		TV mode mainly includes vbyone and an LVDS interface display
		Through the environment variable is to choose panel_type lcd_index

config AMLOGIC_LCD_TABLET
	bool "LCD Tablet Output Module"
	default n
	depends on AMLOGIC_LCD
	help
		LCD Tablet output module
		Configure the LCD output model for Tablet output
		tablet mode mainly includes panel interface display
		Through the environment variable is only choose panel

config AMLOGIC_LCD_SMART_TEMP
	bool "Smart Dispaly Panel Output Module"
	default n
	help
		Smart display panel output module
		Configure the LCD output model for smart display
		Smart display interface mainly includes mipi-dsi, edp, and spi, bt656...
		Through the environment variable is to choose panel_type lcd_index

if AMLOGIC_LCD
source "$(COMMON_DRIVERS_DIR)/drivers/media/vout/lcd/backlight/Kconfig"
source "$(COMMON_DRIVERS_DIR)/drivers/media/vout/lcd/lcd_extern/Kconfig"
endif

endmenu
```

## drivers/media/vout/lcd/ambilight/Kconfig
```kconfig
# SPDX-License-Identifier: (GPL-2.0+ OR MIT)

#
# Ambilight configuration
#
menu "Amlogic Ambilight Support"

config AMLOGIC_AMBILIGHT
	bool "Amlogic ambilight support"
	default n
	help
		Say Y here if you want to use the Ambilight.
		Ambilight can provide rgb sum for each zone.

endmenu
```

## drivers/media/vout/lcd/lcd_tablet/Kconfig
```kconfig
# SPDX-License-Identifier: (GPL-2.0+ OR MIT)


config AMLOGIC_LCD_GAMMA_DEBUG
	bool "LCD Gamma debug support"
	default n
	help
		Amlogic LCD gamma debug
```

## drivers/media/vout/vdac/Kconfig
```kconfig
# SPDX-License-Identifier: (GPL-2.0+ OR MIT)

#
# Video output configuration
#

config AMLOGIC_VDAC
	bool "VDAC Module"
	default n
	help
		VDAC config.
```

## drivers/memory_debug/Kconfig
```kconfig
# SPDX-License-Identifier: (GPL-2.0+ OR MIT)

menu "Meson core memory debug driver"

config AMLOGIC_MEMORY_DEBUG
	tristate "Meson debug driver"
	default n
	help
	  This is the meson memory driver

source "$(COMMON_DRIVERS_DIR)/drivers/memory_debug/memory_ext/Kconfig"
source "$(COMMON_DRIVERS_DIR)/drivers/memory_debug/reg_access/Kconfig"
source "$(COMMON_DRIVERS_DIR)/drivers/memory_debug/ddr_tool/Kconfig"
source "$(COMMON_DRIVERS_DIR)/drivers/memory_debug/ramdump/Kconfig"

endmenu
```

## drivers/memory_debug/memory_ext/Kconfig
```kconfig
# SPDX-License-Identifier: (GPL-2.0+ OR MIT)

config AMLOGIC_FILE_CACHE
	bool "Amlogic file cache"
	depends on AMLOGIC_MEMORY_EXTEND
	default n
	help
	  Memory debug which statisticint filecache information.
	  Enable if doubt.

config AMLOGIC_WATCHPOINT
	bool "Amlogic point driver"
	depends on AMLOGIC_MEMORY_EXTEND
	depends on HAVE_HW_BREAKPOINT
	default n
	help
	  This driver export a debug sysfs in order
	  to using watch point function on ARMv8.
	  say y to enable Amlogic watch point driver
```

## drivers/memory_debug/ramdump/Kconfig
```kconfig
# SPDX-License-Identifier: (GPL-2.0+ OR MIT)

config AMLOGIC_RAMDUMP
	bool "Amlogic full ramdump"
	default n
	help
		Amlogic ramump implementation. When kernel pain is
		generated, the entire ddr data will be compressed and
		copied out. Finally, use the crash tool to debug and
		analyze on the PC side.
```
