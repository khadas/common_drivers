## arch/arm/configs/meson64_a32_zapper_ext_defconfig
```kconfig
CONFIG_AMLOGIC_ZAPPER_NET_CUT=n

CONFIG_PACKET=y
CONFIG_XDP_SOCKETS=y
CONFIG_NETWORK_SECMARK=y
CONFIG_NET_PTP_CLASSIFY=y
CONFIG_NF_CONNTRACK_SECMARK=y
CONFIG_XFRM_USER=y
CONFIG_XFRM_INTERFACE=y
CONFIG_XFRM_MIGRATE=y
CONFIG_XFRM_STATISTICS=y
CONFIG_NET_KEY=y
CONFIG_XDP_SOCKETS=y
CONFIG_INET=y
CONFIG_IP_MULTICAST=y
CONFIG_IP_ADVANCED_ROUTER=y
CONFIG_IP_MULTIPLE_TABLES=y
CONFIG_NET_IPGRE_DEMUX=y
CONFIG_NET_IPVTI=y
CONFIG_INET_ESP=y
CONFIG_INET_UDP_DIAG=y
CONFIG_INET_DIAG_DESTROY=y
CONFIG_IPV6_ROUTER_PREF=y
CONFIG_IPV6_ROUTE_INFO=y
CONFIG_IPV6_OPTIMISTIC_DAD=y
CONFIG_INET6_AH=y
CONFIG_INET6_ESP=y
CONFIG_INET6_IPCOMP=y
CONFIG_IPV6_MIP6=y
CONFIG_IPV6_VTI=y
CONFIG_IPV6_MULTIPLE_TABLES=y
CONFIG_NETFILTER=y
CONFIG_NF_CONNTRACK=y
CONFIG_NF_CONNTRACK_SECMARK=y
CONFIG_NF_CONNTRACK_EVENTS=y
CONFIG_NF_CONNTRACK_AMANDA=y
CONFIG_NF_CONNTRACK_FTP=y
CONFIG_NF_CONNTRACK_H323=y
CONFIG_NF_CONNTRACK_IRC=y
CONFIG_NF_CONNTRACK_NETBIOS_NS=y
CONFIG_NF_CONNTRACK_PPTP=y
CONFIG_NF_CONNTRACK_SANE=y
CONFIG_NF_CONNTRACK_TFTP=y
CONFIG_NF_CT_NETLINK=y
CONFIG_NETFILTER_XT_TARGET_CONNSECMARK=y
CONFIG_NETFILTER_XT_TARGET_SECMARK=y
CONFIG_NETFILTER_XT_TARGET_CLASSIFY=y
CONFIG_NETFILTER_XT_TARGET_CONNMARK=y
CONFIG_NETFILTER_XT_TARGET_CONNSECMARK=y
CONFIG_NETFILTER_XT_TARGET_CT=y
CONFIG_NETFILTER_XT_TARGET_IDLETIMER=y
CONFIG_NETFILTER_XT_TARGET_MARK=y
CONFIG_NETFILTER_XT_TARGET_NFLOG=y
CONFIG_NETFILTER_XT_TARGET_NFQUEUE=y
CONFIG_NETFILTER_XT_TARGET_TPROXY=y
CONFIG_NETFILTER_XT_TARGET_TRACE=y
CONFIG_NETFILTER_XT_TARGET_SECMARK=y
CONFIG_NETFILTER_XT_TARGET_TCPMSS=y
CONFIG_NETFILTER_XT_MATCH_BPF=y
CONFIG_NETFILTER_XT_MATCH_COMMENT=y
CONFIG_NETFILTER_XT_MATCH_CONNLIMIT=y
CONFIG_NETFILTER_XT_MATCH_CONNMARK=y
CONFIG_NETFILTER_XT_MATCH_CONNTRACK=y
CONFIG_NETFILTER_XT_MATCH_HASHLIMIT=y
CONFIG_NETFILTER_XT_MATCH_HELPER=y
CONFIG_NETFILTER_XT_MATCH_IPRANGE=y
CONFIG_NETFILTER_XT_MATCH_LENGTH=y
CONFIG_NETFILTER_XT_MATCH_LIMIT=y
CONFIG_NETFILTER_XT_MATCH_MAC=y
CONFIG_NETFILTER_XT_MATCH_MARK=y
CONFIG_NETFILTER_XT_MATCH_OWNER=y
CONFIG_NETFILTER_XT_MATCH_POLICY=y
CONFIG_NETFILTER_XT_MATCH_PKTTYPE=y
CONFIG_NETFILTER_XT_MATCH_QUOTA=y
CONFIG_NETFILTER_XT_MATCH_QUOTA2=y
CONFIG_NETFILTER_XT_MATCH_QUOTA2_LOG=y
CONFIG_NETFILTER_XT_MATCH_SOCKET=y
CONFIG_NETFILTER_XT_MATCH_STATE=y
CONFIG_NETFILTER_XT_MATCH_STATISTIC=y
CONFIG_NETFILTER_XT_MATCH_STRING=y
CONFIG_NETFILTER_XT_MATCH_TIME=y
CONFIG_NETFILTER_XT_MATCH_U32=y
CONFIG_IP_NF_SECURITY=y
CONFIG_IP_NF_IPTABLES=y
CONFIG_IP_NF_MATCH_AH=y
CONFIG_IP_NF_MATCH_ECN=y
CONFIG_IP_NF_MATCH_TTL=y
CONFIG_IP_NF_FILTER=y
CONFIG_IP_NF_TARGET_REJECT=y
CONFIG_IP_NF_NAT=y
CONFIG_IP_NF_TARGET_MASQUERADE=y
CONFIG_IP_NF_TARGET_NETMAP=y
CONFIG_IP_NF_TARGET_REDIRECT=y
CONFIG_IP_NF_MANGLE=y
CONFIG_IP_NF_RAW=y
CONFIG_IP_NF_SECURITY=y
CONFIG_IP_NF_ARPTABLES=y
CONFIG_IP_NF_ARPFILTER=y
CONFIG_IP_NF_ARP_MANGLE=y
CONFIG_IP6_NF_IPTABLES=y
CONFIG_IP6_NF_MATCH_RPFILTER=y
CONFIG_IP6_NF_FILTER=y
CONFIG_IP6_NF_TARGET_REJECT=y
CONFIG_IP6_NF_MANGLE=y
CONFIG_IP6_NF_RAW=y
CONFIG_L2TP=y
CONFIG_NET_SCHED=y
CONFIG_NET_SCH_HTB=y
CONFIG_NET_SCH_TBF=y
CONFIG_NET_SCH_NETEM=y
CONFIG_NET_SCH_INGRESS=y
CONFIG_NET_CLS_U32=y
CONFIG_NET_CLS_BPF=y
CONFIG_NET_CLS_MATCHALL=y
CONFIG_NET_EMATCH=y
CONFIG_NET_EMATCH_U32=y
CONFIG_NET_CLS_ACT=y
CONFIG_NET_ACT_POLICE=y
CONFIG_NET_ACT_BPF=y
CONFIG_RFKILL=y
CONFIG_RFKILL_INPUT=y
CONFIG_RFKILL_GPIO=y
CONFIG_MD=y
CONFIG_BLK_DEV_DM=y
CONFIG_DM_CRYPT=y
CONFIG_DM_DEFAULT_KEY=y
CONFIG_DM_SNAPSHOT=y
CONFIG_DM_UEVENT=y
CONFIG_DM_VERITY=y
CONFIG_DM_VERITY_FEC=y
CONFIG_NETDEVICES=y
CONFIG_DUMMY=y
CONFIG_TUN=y
CONFIG_VETH=y
CONFIG_PPP=y
CONFIG_PPP_BSDCOMP=y
CONFIG_PPP_DEFLATE=y
CONFIG_PPP_MPPE=y
CONFIG_PPTP=y
CONFIG_PPPOL2TP=y
CONFIG_USB_RTL8152=y
CONFIG_USB_USBNET=y
CONFIG_NET_SOCK_MSG=y
CONFIG_PAGE_POOL=y

CONFIG_STMMAC_ETH=y
CONFIG_STMMAC_PLATFORM=y
CONFIG_DWMAC_MESON=y
CONFIG_AMLOGIC_ETH_PRIVE=y
#CONFIG_NETDEVICES=y
CONFIG_PHYLINK=y
CONFIG_PHYLIB=y
CONFIG_SWPHY=y
CONFIG_FIXED_PHY=y
CONFIG_OF_MDIO=y
CONFIG_MDIO_DEVRES=y
CONFIG_MDIO_BUS_MUX=y
CONFIG_AMLOGIC_MDIO_G12A=y
CONFIG_AMLOGIC_INPHY=y
CONFIG_DWMAC_DWC_QOS_ETH=y
CONFIG_POSIX_TIMERS=y
CONFIG_CFG80211=m
CONFIG_MAC80211=m

CONFIG_RFKILL_LEDS=y
CONFIG_ETHTOOL_NETLINK=y
CONFIG_MTD_UBI=y
CONFIG_ZRAM_DEF_COMP_ZSTD=y

### DOS/FAT/EXFAT/NT Filesystems
CONFIG_FAT_FS=y
CONFIG_MSDOS_FS=y
CONFIG_VFAT_FS=y
CONFIG_EXFAT_FS=y
CONFIG_MSDOS_PARTITION=y
CONFIG_NLS_CODEPAGE_437=y
CONFIG_NLS_ISO8859_1=y
CONFIG_NLS_UTF8=y
CONFIG_UNICODE=y

### USB support
CONFIG_USB_HID=y
CONFIG_USB_HIDDEV=y
#CONFIG_USB_ANNOUNCE_NEW_DEVICES=y
CONFIG_USB_OTG=y
CONFIG_USB_XHCI_HCD=y
CONFIG_USB_STORAGE=y
```

## arch/arm64/configs/amlogic_upgrade.defconfig
```kconfig
# SPDX-License-Identifier: (GPL-2.0+ OR MIT)

# amlogic-uart
CONFIG_AMLOGIC_SERIAL_MESON=y

# amlogic-gkitool
CONFIG_AMLOGIC_GKI_TOOL=y

# amlogic-debug
CONFIG_AMLOGIC_DEBUG=y

# amlogic-memory-debug
CONFIG_AMLOGIC_MEMORY_DEBUG=y

# amlogic-secmon
CONFIG_AMLOGIC_SECMON=y

# amlogic-clk
CONFIG_AMLOGIC_COMMON_CLK=y

# amlogic-clk-soc-xxx
CONFIG_AMLOGIC_COMMON_CLK_S4=y
CONFIG_AMLOGIC_COMMON_CLK_SC2=y
CONFIG_AMLOGIC_COMMON_CLK_C2=y
CONFIG_AMLOGIC_COMMON_CLK_C3=y
CONFIG_AMLOGIC_COMMON_CLK_A1=y
CONFIG_AMLOGIC_COMMON_CLK_T3=y
CONFIG_AMLOGIC_COMMON_CLK_T7=y
CONFIG_AMLOGIC_COMMON_CLK_T5M=y

# amlogic-gpio
CONFIG_AMLOGIC_GPIO=y

# amlogic-pinctrl-soc-xxx
CONFIG_AMLOGIC_PINCTRL_MESON_S4=y
CONFIG_AMLOGIC_PINCTRL_MESON_C2=y
CONFIG_AMLOGIC_PINCTRL_MESON_C3=y
CONFIG_AMLOGIC_PINCTRL_MESON_A1=y
CONFIG_AMLOGIC_PINCTRL_MESON_SC2=y
CONFIG_AMLOGIC_PINCTRL_MESON_T3=y
CONFIG_AMLOGIC_PINCTRL_MESON_T7=y
CONFIG_AMLOGIC_PINCTRL_MESON_T5M=y

# amlogic-mailbox
CONFIG_AMLOGIC_MHU_MBOX=y

# amlogic-pwm
CONFIG_AMLOGIC_PWM_MESON=y

# pwm-regulator
CONFIG_REGULATOR_PWM=y

# amlogic-power
CONFIG_AMLOGIC_POWER=y

# amlogic-cpuinfo
CONFIG_AMLOGIC_CPU_INFO=y

# amlogic-cpufreq
CONFIG_AMLOGIC_MESON_CPUFREQ=y

# amlogic-reset
CONFIG_AMLOGIC_RESET_MESON=y

# amlogic-efuse-unifykey
CONFIG_AMLOGIC_EFUSE_UNIFYKEY=y

# amlogic-mmc
CONFIG_AMLOGIC_MMC_MESON_GX=y

# system_heap
CONFIG_DMABUF_HEAPS_SYSTEM=y

# amlogic-i2c
CONFIG_AMLOGIC_I2C_MESON=y

# amlogic-spi
CONFIG_AMLOGIC_SPI=y

# amlogic-rng
CONFIG_AMLOGIC_HW_RANDOM_MESON=y

# amlogic-tee
CONFIG_AML_TEE=y
CONFIG_AML_OPTEE=y
CONFIG_AMLOGIC_TEE=y

# videobuf-core
CONFIG_AMLOGIC_MEDIA_UTILS=y

# dvb-core
CONFIG_DVB_CORE=y

# amlogic-pm
CONFIG_AMLOGIC_PM=y

# amlogic-input
CONFIG_AMLOGIC_INPUT=y

# amlogic-watchdog
CONFIG_AMLOGIC_MESON_GXBB_WATCHDOG=y

# amlogic-dvb
CONFIG_AMLOGIC_DVB_CONFIG=y

# amlogic-dvb-ci
# CONFIG_AMLOGIC_DVB_CI=y

# aml_media
CONFIG_AMLOGIC_MEDIA_MODULE=y
CONFIG_FB=y
CONFIG_AMLOGIC_MEDIA_FB=y
CONFIG_AMLOGIC_MEDIA_FB_OSD_SYNC_FENCE=y
CONFIG_AMLOGIC_MEDIA_FB_OSD_VSYNC_RDMA=y
CONFIG_AMLOGIC_MEDIA_FB_OSD2_ENABLE=y
CONFIG_AMLOGIC_MEDIA_FB_OSD2_CURSOR=y
```

## arch/arm64/configs/amlogic_upgrade_p.defconfig
```kconfig
# amlogic-hwspinlock.ko
CONFIG_AMLOGIC_HWSPINLOCK=y

# amlogic-camera.ko
# amlogic-camera.ko
CONFIG_AMLOGIC_VIDEO_CAPTURE=y
CONFIG_AMLOGIC_VM_DISABLE_VIDEOLAYER=y
CONFIG_AMLOGIC_VIDEO_CAPTURE_OV5640=y

# amlogic-adc.ko
CONFIG_AMLOGIC_MESON_SARADC=y
CONFIG_AMLOGIC_IIO_KFIFO_BUF=y

# amlogic-thermal.ko
CONFIG_AMLOGIC_AMLOGIC_THERMAL=y
CONFIG_AMLOGIC_COOLDEV=y
CONFIG_AMLOGIC_CPUCORE_THERMAL=y
CONFIG_AMLOGIC_GPU_THERMAL=y
CONFIG_AMLOGIC_GPUCORE_THERMAL=y
CONFIG_AMLOGIC_DDR_THERMAL=y

# amlogic-usb ko
CONFIG_AMLOGIC_USB=y
CONFIG_AMLOGIC_USB_SUPPORT=y
CONFIG_AMLOGIC_USB2PHY=y
CONFIG_AMLOGIC_USBPHY=y
CONFIG_AMLOGIC_USB3PHY=y
CONFIG_AMLOGIC_CRG=y

# amlogic-irblaster.ko
CONFIG_AMLOGIC_IRBLASTER=y

# etherent
CONFIG_STMMAC_ETH=y
CONFIG_DWMAC_MESON=y
CONFIG_DWMAC_DWC_QOS_ETH=y
CONFIG_AMLOGIC_MDIO_G12A=y
CONFIG_AMLOGIC_INPHY=y
CONFIG_AMLOGIC_ETH_PRIVE=y
CONFIG_DWMAC_IPQ806X=n
CONFIG_DWMAC_QCOM_ETHQOS=n
CONFIG_DWMAC_SUNXI=n
CONFIG_DWMAC_SUN8I=n
CONFIG_DWMAC_GENERIC=n

# aml_drm.ko
CONFIG_AMLOGIC_DRM=y
CONFIG_AMLOGIC_DRM_VPU=y
CONFIG_AMLOGIC_DRM_HDMI=y
CONFIG_AMLOGIC_DRM_USE_ION=y

# sdcardfs
CONFIG_SDCARD_FS=y

# android P need
# CONFIG_ANDROID_BINDERFS is not set
CONFIG_ANDROID_LOW_MEMORY_KILLER=y
CONFIG_AMLOGIC_LMK=y
```
