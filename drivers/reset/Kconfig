## drivers/reset/Kconfig
```kconfig
# SPDX-License-Identifier: (GPL-2.0+ OR MIT)

if RESET_CONTROLLER

config AMLOGIC_RESET_MESON
	tristate "Meson Reset Driver"
	help
	  This enables the reset driver for Amlogic Meson SoCs.

endif
```

## drivers/rtc/Kconfig
```kconfig
# SPDX-License-Identifier: (GPL-2.0+ OR MIT)

comment "RTC drivers"

if RTC_CLASS

config AMLOGIC_RTC
	tristate "Platform rtc drivers support"
	default n
	help
	  rtc drivers support
	  select y for built-in
	  select m for ko
	  select n for disable

config AMLOGIC_RTC_DRV_MESON_VRTC
	bool "Amlogic Meson Virtual RTC"
	depends on AMLOGIC_RTC
	default n
	help
	  If you say yes here you will get support for the
	  Virtual RTC of Amlogic SoCs.

	  This driver can also be built as a module. If so, the module
	  will be called rtc-meson-vrtc.

config AMLOGIC_MESON_RTC
	bool "Amlogic Meson RTC driver"
	depends on AMLOGIC_RTC
	default n
	help
	  This is the Amlogic rtc driver.

	  This driver can also be built as a module. If so, the module
	  will be called meson-rtc.

endif # RTC_CLASS
```

## drivers/rtc/meson_pmic6b/Kconfig
```kconfig
# SPDX-License-Identifier: (GPL-2.0+ OR MIT)
#
# AMLOGIC_RTC_PMIC6B configuration
#

menu  "RTC_PMIC6B SUPPORT"

config AMLOGIC_RTC_PMIC6B
	bool "Amlogic RTC PMIC6B"
	depends on AMLOGIC_MFD
	depends on AMLOGIC_MFD_PMIC6B
	depends on RTC_CLASS
	default n
	help
	  Say yes here to add support for the Amlogic RTC PMIC.
	  Say no here to don't add support for the Amlogic RTC PMIC.
	  Default is yes, and add support for the Amlogic RTC PMIC.

endmenu
```

## drivers/seckey/Kconfig
```kconfig
# SPDX-License-Identifier: (GPL-2.0+ OR MIT)
#
# SECKEY drivers configuration
#

config AMLOGIC_SECKEY
	tristate "amlogic secure key Support"
	default n
	help
		amlogic keyladder/keytable support
		select y to enable
		select m for module
		select n to disable

config AMLOGIC_SECKEY_KT
	tristate "amlogic Keytable driver"
	depends on AMLOGIC_SECKEY
	default n
	help
		Keytable driver using the H/W keytable.
		This module deposits keys into h/w KeyTable with usage flags.

config AMLOGIC_SECKEY_KL
	tristate "amlogic Keyladder driver"
	depends on AMLOGIC_SECKEY
	default n
	help
		Keyladder driver supporting the ETSI/AML keyladder.
		This module gets KL keys deposited into KeyTable with usage flags.
```

## drivers/secmon/Kconfig
```kconfig
# SPDX-License-Identifier: (GPL-2.0+ OR MIT)

config AMLOGIC_SECMON
	tristate "Amlogic secure monitor driver support"
	default n
	help
	  This is the Amlogic secure monitor driver
	  this config only ctrl in makefile
	  prepare share memory
	  etc

config AMLOGIC_DOLBY_FW
	bool "Dolby FW kernel driver"
	depends on AMLOGIC_SECMON
	default n
	help
	  This is Dolby FW Driver.
```

## drivers/soc_info/Kconfig
```kconfig
# SPDX-License-Identifier: (GPL-2.0+ OR MIT)

config	AMLOGIC_SOC_INFO
	tristate "Amlogic soc"
	default n
	help
	  say y to enable Amlogic chipid driver.
```

## drivers/spi/Kconfig
```kconfig
# SPDX-License-Identifier: (GPL-2.0+ OR MIT)

menuconfig AMLOGIC_SPI
	tristate "Amlogic SoC SPI Hardware Bus support"
	depends on SPI

config AMLOGIC_SPI_MESON_SPICC
	tristate "Amlogic Meson SPICC controller"
	help
	  This enables master mode support for the SPICC (SPI communication
	  controller) available in Amlogic Meson SoCs.

config AMLOGIC_SPI_MESON_SPIFC
	tristate "Amlogic Meson SPIFC controller"
	depends on REGMAP_MMIO
	help
	  This enables master mode support for the SPIFC (SPI flash
	  controller) available in Amlogic Meson SoCs.

config AMLOGIC_SPI_MESON_SPIFC_V2
	tristate "Amlogic Meson SPIFC v2 controller"
	depends on REGMAP_MMIO
	help
	  This enables master mode support for the SPIFC_V2 (SPI flash
	  V2 controller) available in A1, C1, C2, Amlogic Meson SoCs.
	  If you need to use meson spinand or spinor, you must enable
	  it.

config AMLOGIC_SPI_MESON_SPICC_SLAVE
	tristate "Amlogic Meson SPICC Slave controller"
	help
	  This enables slave mode support for the SPICC (SPI communication
	  controller) available in Amlogic Meson SoCs. SPICC can work both
	  in master mode and slave mode.
	  say Y or M here.If you are not sure, say N.
```

## drivers/tee/Kconfig
```kconfig
# SPDX-License-Identifier: (GPL-2.0+ OR MIT)

config AMLOGIC_TEE
	tristate "TEE Support for Amlogic"
	depends on AMLOGIC_AMLTEE
	default n
	help
	  Amlogic TEE driver

	  Provide TEE APIs and Debug interface in sysfs, depends on the
	  tee os.
```

## drivers/thermal/Kconfig
```kconfig
# SPDX-License-Identifier: (GPL-2.0+ OR MIT)

menu "Amlogic Thermal and Cooling devices"

config AMLOGIC_AMLOGIC_THERMAL
	tristate "Amlogic temperature sensor Support"
	depends on THERMAL && AMLOGIC_SECMON
	default n
	help
		Thermal sensor low level support for thermal
		This driver parse thermal config data from device tree files.
		And register each cooling device for thermal framework.

		If you want this support, you should say Y here.

config AMLOGIC_COOLDEV
	tristate "Amlogic cooling devices Support"
	default n
	help
		This implements the all cooling devices
		This will be useful for platforms using the generic thermal interface
		and not the ACPI interface.

		If you want this support, you should say Y here.

config AMLOGIC_CPUCORE_THERMAL
	tristate "generic cpu core cooling support"
	depends on AMLOGIC_COOLDEV
	default n
	help
		This implements the generic cpu cooling mechanism through reduce cpu core numbers
		This will be useful for platforms using the generic thermal interface
		and not the ACPI interface.

		If you want this support, you should say Y here.

config AMLOGIC_GPU_THERMAL
	tristate "generic gpu cooling support"
	depends on AMLOGIC_COOLDEV
	default n
	help
		This implements the generic gpu cooling mechanism through frequency reduction
		This will be useful for platformas using the generic thermal interface
		and not the ACPI interface.

		If you want this support, you should say Y here.

config AMLOGIC_GPUCORE_THERMAL
	tristate "generic gpu core cooling support"
	depends on AMLOGIC_COOLDEV
	default n
	help
		This implements the generic gpu cooling mechanism through reduce gpu core numbers.
		This will be useful for platforms using the generic thermal interface
		and not the ACPI interface.

		If you want this support, you should say Y here.

config AMLOGIC_DDR_THERMAL
	tristate "generic ddr cooling support"
	depends on AMLOGIC_COOLDEV
	default n
	help
		This implements change the ddr reflash rate.
		This will be useful for platforms using the generic thermal interface
		and not the ACPI interface.

		If you want this support, you should say Y here.

endmenu
```

## drivers/timestamp/Kconfig
```kconfig
# SPDX-License-Identifier: GPL-2.0-only

config AMLOGIC_SOC_TIMESTAMP
	tristate "Amlogic SoC Timestamp"
	depends on OF
	default n
	help
	  Say yes if you want to get soc-level timestamp.
```

## drivers/tty/serial/Kconfig
```kconfig
# SPDX-License-Identifier: (GPL-2.0+ OR MIT)
#
# Amlogic driver configuration
#

config AMLOGIC_SERIAL_MESON
	tristate "Meson serial port support"
	select SERIAL_CORE
	default n
	help
	  This enables the driver for the on-chip UARTs of the Amlogic
	  MesonX processors.

config AMLOGIC_SERIAL_EARLY_CONSOLE
	bool "Early console on Amlogic Serial port"
	depends on AMLOGIC_SERIAL_MESON
	select SERIAL_EARLYCON
	default n
	help
	  Say Y here if you wish to use a Amlogic MesonX UART as the
	  system console (the system console is the device which
	  receives all kernel messages and warnings and which allows
	  logins in single user mode) as /dev/ttyAMLx.

config AMLOGIC_SERIAL_MESON_CONSOLE
	bool "Console on Amlogic Serial port"
	depends on AMLOGIC_SERIAL_MESON
	select SERIAL_CORE_CONSOLE
	default n
	help
	  Say Y here if you wish to use a Amlogic MesonX UART as the
	  system console (the system console is the device which
	  receives all kernel messages and warnings and which allows
	  logins in single user mode) as /dev/ttyAMLx.
```

## drivers/usb/Kconfig
```kconfig
# SPDX-License-Identifier: GPL-2.0

menu "USB Support"

config AMLOGIC_USB
	bool "Amlogic USB controller support"
	default n
	select USB_PHY
	depends on USB
	help
	  DWC_OTG
	  USB
	  host
	  controller.

config AMLOGIC_COMMON_USB
	bool "It is used to cover the USB modification for common dir."
	default n
	depends on AMLOGIC_USB
	depends on AMLOGIC_BREAK_GKI_20
	help
	  DWC_OTG
	  USB
	  host
	  controller.

config AMLOGIC_USB_SUPPORT
	tristate "USB Host controller and phy support"
	depends on AMLOGIC_USB
	help
	  USB Host
	  controller
	  dwc_otg
	  support

config AMLOGIC_USB_DWC_OTG_HCD
	tristate "USB Host controller dwc_otg support"
	depends on AMLOGIC_USB
	help
	  USB Host
	  controller
	  dwc_otg
	  support

config AMLOGIC_CRG
        bool "USB Host controller corigine support"
        depends on AMLOGIC_USB
        help
          USB Host
          controller
          corigine
          support

config AMLOGIC_USBPHY
	bool "Amlogic USB PHY Driver"
	depends on AMLOGIC_USB
	help
	  Enable this to support Amlogic USB phy helper driver for Amlogic SoCs.
	  This driver provides common interface to interact, for Amlogic USB 2.0 PHY
	  driver and later for Amlogic USB 3.0 PHY driver.

	  This driver supports GXBABYTV and G9TV.

          To compile this driver as a module, choose M here: the
          module will be called phy-aml-usb.

config AMLOGIC_USB2PHY
	bool "Amlogic USB 2.0 PHY controller Driver"
	depends on AMLOGIC_USBPHY
	help
	  Enable this to support Amlogic USB 2.0 (High Speed) PHY controller
	  for Amlogic SoCs.

	  This driver supports GXBABYTV and G9TV.

	  To compile this driver as a module, choose M here: the
          module will be called phy-aml-usb.

config AMLOGIC_USB3PHY
	bool "Amlogic USB 3.0 PHY controller Driver"
	depends on AMLOGIC_USBPHY
	help
	  Enable this to support Amlogic USB 3.0 (Super Speed) phy controller
	  for Amlogic SoCs.

	  This driver supports GXBABYTV and G9TV.

          To compile this driver as a module, choose M here: the
          module will be called phy-aml-usb.

config AMLOGIC_USBPHYC2
	bool "Amlogic C2 USB PHY controller Driver"
	depends on AMLOGIC_USBPHY
	help
	  Enable this to support Amlogic USB phy controller
	  for Amlogic SoCs.

	  This driver supports GXBABYTV and G9TV.

	  To compile this driver as a module, choose M here: the
	  module will be called phy-aml-usb.

config AMLOGIC_BC
        bool "Amlogic BC detect Driver"
        depends on AMLOGIC_USB
        help
          Enable this to support Amlogic BC detect for Amlogic SoCs.

          This driver supports C2.

          To compile this driver as a module, choose M here: the
          module will be called amlogic-bc.

config AMLOGIC_CC
        bool "Amlogic CC detect Driver"
        depends on AMLOGIC_USB
        help
          Enable this to support Amlogic CC detect for Amlogic SoCs.

          This driver supports C2.

          To compile this driver as a module, choose M here: the
          module will be called amlogic-cc.
endmenu
```

## drivers/watchdog/Kconfig
```kconfig
# SPDX-License-Identifier: (GPL-2.0+ OR MIT)

if WATCHDOG

comment "Watchdog Device Drivers"

config AMLOGIC_MESON_GXBB_WATCHDOG
	tristate "Amlogic Meson GXBB SoCs watchdog support"
	depends on WATCHDOG_CORE
	help
	  Say Y here to include support for the watchdog timer
	  in Amlogic Meson GXBB SoCs.
	  To compile this driver as a module, choose M here: the
	  module will be called meson_gxbb_wdt.

config AMLOGIC_ARM_SMC_WATCHDOG
	tristate "ARM Secure Monitor Call based watchdog support"
	depends on ARM || ARM64
	depends on OF
	depends on HAVE_ARM_SMCCC
	depends on WATCHDOG_CORE
	help
	  Say Y here to include support for a watchdog timer
	  implemented by the EL3 Secure Monitor on ARM platforms.
	  Requires firmware support.
	  To compile this driver as a module, choose M here: the
	  module will be called arm_smc_wdt.

endif # WATCHDOG
```

## drivers/wireless/Kconfig
```kconfig
# SPDX-License-Identifier: (GPL-2.0+ OR MIT)

config AMLOGIC_WIRELESS
	tristate "Amlogic wifi and bluetooth support"
	default n
	help
	  wifi and bluetooth support
	  select y for built-in
	  select m for ko
	  select n for disable

if AMLOGIC_WIRELESS
source "$(COMMON_DRIVERS_DIR)/drivers/wireless/bluetooth/Kconfig"
source "$(COMMON_DRIVERS_DIR)/drivers/wireless/wifi/Kconfig"
endif
```

## drivers/wireless/bluetooth/Kconfig
```kconfig
# SPDX-License-Identifier: (GPL-2.0+ OR MIT)

config AMLOGIC_BLUETOOTH
	bool "BT Device support"
	depends on BT && RFKILL
	default n
	help
	  Say Y here if you want to use the BT device.
```

## drivers/wireless/wifi/Kconfig
```kconfig
# SPDX-License-Identifier: (GPL-2.0+ OR MIT)

menuconfig AMLOGIC_WIFI
	bool "WiFi support"
	select WIRELESS_EXT
	select WEXT_PRIV
	default n
	help
		select y to support wifi

if AMLOGIC_WIFI

config AMLOGIC_PWM_32K
	bool "amlogic soc pwm 32k support"
	depends on AMLOGIC_PWM_MESON
	default y
	help
		WiFi usually needs a 32K frequency clock signal.
		There are three possibilities:
		using the internal 32K clock or using the 32K input from our SOC,
		or using the onboard active 32K crystal oscillator.
		By default,32K of SOC input is enabled,
		if not, you can disable it by selecting n.

endif
```

## samples/debug_file_test/Kconfig
```kconfig
# SPDX-License-Identifier: (GPL-2.0+ OR MIT)

source "$(COMMON_DRIVERS_DIR)/samples/debug_file_test/drivers_test/Kconfig"
```

## samples/debug_file_test/drivers_test/Kconfig
```kconfig
# SPDX-License-Identifier: (GPL-2.0+ OR MIT)

config AMLOGIC_SAMPLES_DEBUG_FILE_TEST
	tristate "Amlogic debug file test support"
	depends on AMLOGIC_DEBUG_FILE
	default n
	help
		This builds an Amlogic debug file function example
```

## scripts/Kconfig
```kconfig
config AMLOGIC_FDTO_REMOVE_NODE
	bool "Amlogic Fdtoverlay Remove Node"
	default n
	help
	  Fdtoverlay support remove dtb node.
```

## sound/Kconfig
```kconfig
# SPDX-License-Identifier: (GPL-2.0+ OR MIT)

if SOUND
if !UML
if SND
source "$(COMMON_DRIVERS_DIR)/sound/soc/Kconfig"
endif # SND
endif # !UML
endif # SOUND
```

## sound/soc/Kconfig
```kconfig
# SPDX-License-Identifier: (GPL-2.0+ OR MIT)

if SND_SOC
source "$(COMMON_DRIVERS_DIR)/sound/soc/amlogic/Kconfig"
source "$(COMMON_DRIVERS_DIR)/sound/soc/codecs/Kconfig"
endif   # SND_SOC
```

## sound/soc/amlogic/Kconfig
```kconfig
# SPDX-License-Identifier: (GPL-2.0+ OR MIT)

#
# Amlogic SoC audio configuration
#

config AMLOGIC_SND_SOC
	tristate "Amlogic ASoC"
	default n
	help
	  Say Y or M if you want to add support for codecs attached to
	  the Amlogic Asoc interface. You will also need
	  to select the audio interfaces to support below.
	  Amlogic ALSA SOC Driver

config AMLOGIC_SND_SOC_AUGE
	bool "Amlogic Auge Asoc"
	depends on AMLOGIC_SND_SOC
	default n
	help
	  Say Y or M if you want to add support for audio arch Auge
	  to the Amlogic Asoc Interface. it is a new audio arch to
	  distinguish Meson audio arch. it is base on kernel 4.9
	  Amlogic New SOC for New Audio ARCH

config AMLOGIC_SND_SOC_COMMON
        bool "Amlogic Common for ASoC"
        default n
        help
	  Say Y or M if you want to add support for common interface attached to
	  the Amlogic Asoc interface. You will also need
	  to select the audio interfaces to support below.

if AMLOGIC_SND_SOC
source "$(COMMON_DRIVERS_DIR)/sound/soc/amlogic/common/amaudio/Kconfig"
source "$(COMMON_DRIVERS_DIR)/sound/soc/amlogic/common/audiodsp/Kconfig"
source "$(COMMON_DRIVERS_DIR)/sound/soc/amlogic/common/audioinfo/Kconfig"
endif
```

## sound/soc/amlogic/common/audioinfo/Kconfig
```kconfig
# audio info  configuration
#
config AMLOGIC_AUDIO_INFO
	bool "Amlogic audio info support"
	default n
	help
	  support the amlogic audio info;
```

## sound/soc/codecs/Kconfig
```kconfig
# SPDX-License-Identifier: (GPL-2.0+ OR MIT)

source "$(COMMON_DRIVERS_DIR)/sound/soc/codecs/amlogic/Kconfig"
```
