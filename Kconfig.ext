## arch/arm64/configs/meson64_a64_smarthome_defconfig
```kconfig
CONFIG_SYSVIPC=y
CONFIG_POSIX_MQUEUE=y
CONFIG_NO_HZ=y
CONFIG_HIGH_RES_TIMERS=y
CONFIG_PREEMPT=y
CONFIG_IRQ_TIME_ACCOUNTING=y
CONFIG_TASKSTATS=y
CONFIG_TASK_DELAY_ACCT=y
CONFIG_TASK_XACCT=y
CONFIG_TASK_IO_ACCOUNTING=y
CONFIG_IKCONFIG=y
CONFIG_IKCONFIG_PROC=y
CONFIG_LOG_BUF_SHIFT=18
CONFIG_CGROUPS=y
CONFIG_MEMCG=y
CONFIG_CGROUP_FREEZER=y
CONFIG_CPUSETS=y
CONFIG_CGROUP_CPUACCT=y
CONFIG_BLK_DEV_INITRD=y
# CONFIG_RD_BZIP2 is not set
# CONFIG_RD_LZMA is not set
# CONFIG_RD_XZ is not set
# CONFIG_RD_LZO is not set
# CONFIG_RD_LZ4 is not set
# CONFIG_RD_ZSTD is not set
# CONFIG_FHANDLE is not set
CONFIG_KCMP=y
CONFIG_EMBEDDED=y
# CONFIG_SLUB_DEBUG is not set
# CONFIG_COMPAT_BRK is not set
CONFIG_PROFILING=y
# CONFIG_ARM64_ERRATUM_832075 is not set
# CONFIG_ARM64_ERRATUM_1319367 is not set
# CONFIG_ARM64_ERRATUM_1508412 is not set
# CONFIG_CAVIUM_ERRATUM_22375 is not set
# CONFIG_CAVIUM_ERRATUM_23154 is not set
# CONFIG_FUJITSU_ERRATUM_010001 is not set
# CONFIG_HISILICON_ERRATUM_161600802 is not set
# CONFIG_QCOM_FALKOR_ERRATUM_1003 is not set
# CONFIG_QCOM_FALKOR_ERRATUM_1009 is not set
# CONFIG_QCOM_QDF2400_ERRATUM_0065 is not set
# CONFIG_QCOM_FALKOR_ERRATUM_E1041 is not set
# CONFIG_NVIDIA_CARMEL_CNP_ERRATUM is not set
# CONFIG_SOCIONEXT_SYNQUACER_PREITS is not set
CONFIG_SCHED_MC=y
CONFIG_NR_CPUS=4
CONFIG_ARM64_SW_TTBR0_PAN=y
CONFIG_COMPAT=y
CONFIG_ARMV8_DEPRECATED=y
CONFIG_SWP_EMULATION=y
CONFIG_CP15_BARRIER_EMULATION=y
CONFIG_SETEND_EMULATION=y
CONFIG_RANDOMIZE_BASE=y
# CONFIG_EFI is not set
CONFIG_PM_AUTOSLEEP=y
CONFIG_PM_WAKELOCKS=y
CONFIG_PM_WAKELOCKS_LIMIT=0
CONFIG_PM_DEBUG=y
CONFIG_ENERGY_MODEL=y
CONFIG_CPU_IDLE=y
CONFIG_ARM_CPUIDLE=y
CONFIG_ARM_PSCI_CPUIDLE=y
CONFIG_CPU_FREQ=y
CONFIG_CPU_FREQ_STAT=y
CONFIG_ARM64_CRYPTO=y
CONFIG_CRYPTO_SHA1_ARM64_CE=y
CONFIG_CRYPTO_SHA2_ARM64_CE=y
CONFIG_CRYPTO_GHASH_ARM64_CE=y
CONFIG_CRYPTO_AES_ARM64_CE_CCM=y
CONFIG_CRYPTO_AES_ARM64_CE_BLK=y
CONFIG_KPROBES=y
CONFIG_JUMP_LABEL=y
CONFIG_MODULES=y
CONFIG_MODULE_UNLOAD=y
CONFIG_MODVERSIONS=y
# CONFIG_CORE_DUMP_DEFAULT_ELF_HEADERS is not set
CONFIG_MEMORY_FAILURE=y
CONFIG_CMA=y
CONFIG_ZSMALLOC=y
# CONFIG_ZONE_DMA32 is not set
CONFIG_PERCPU_STATS=y
CONFIG_NET=y
CONFIG_PACKET=y
CONFIG_UNIX=y
CONFIG_XFRM_USER=y
CONFIG_NET_KEY=y
CONFIG_INET=y
CONFIG_IP_MULTICAST=y
CONFIG_IP_ADVANCED_ROUTER=y
CONFIG_IP_MULTIPLE_TABLES=y
CONFIG_IP_PNP=y
CONFIG_IP_PNP_DHCP=y
CONFIG_IP_PNP_BOOTP=y
CONFIG_INET_ESP=y
CONFIG_INET_DIAG_DESTROY=y
CONFIG_IPV6_ROUTER_PREF=y
CONFIG_IPV6_ROUTE_INFO=y
CONFIG_IPV6_OPTIMISTIC_DAD=y
CONFIG_INET6_AH=y
CONFIG_INET6_ESP=y
CONFIG_INET6_IPCOMP=y
CONFIG_IPV6_MIP6=y
CONFIG_IPV6_MULTIPLE_TABLES=y
CONFIG_NETFILTER=y
CONFIG_NF_CONNTRACK=y
CONFIG_NF_CONNTRACK_EVENTS=y
CONFIG_NF_CONNTRACK_AMANDA=y
CONFIG_NF_CONNTRACK_FTP=y
CONFIG_NF_CONNTRACK_H323=y
CONFIG_NF_CONNTRACK_IRC=y
CONFIG_NF_CONNTRACK_NETBIOS_NS=y
CONFIG_NF_CONNTRACK_PPTP=y
CONFIG_NF_CONNTRACK_SANE=y
CONFIG_NF_CONNTRACK_TFTP=y
CONFIG_NF_CT_NETLINK=y
CONFIG_NETFILTER_XT_TARGET_CLASSIFY=y
CONFIG_NETFILTER_XT_TARGET_CONNMARK=y
CONFIG_NETFILTER_XT_TARGET_IDLETIMER=y
CONFIG_NETFILTER_XT_TARGET_MARK=y
CONFIG_NETFILTER_XT_TARGET_NFLOG=y
CONFIG_NETFILTER_XT_TARGET_NFQUEUE=y
CONFIG_NETFILTER_XT_TARGET_TPROXY=y
CONFIG_NETFILTER_XT_TARGET_TRACE=y
CONFIG_NETFILTER_XT_TARGET_TCPMSS=y
CONFIG_NETFILTER_XT_MATCH_COMMENT=y
CONFIG_NETFILTER_XT_MATCH_CONNLIMIT=y
CONFIG_NETFILTER_XT_MATCH_CONNMARK=y
CONFIG_NETFILTER_XT_MATCH_CONNTRACK=y
CONFIG_NETFILTER_XT_MATCH_HASHLIMIT=y
CONFIG_NETFILTER_XT_MATCH_HELPER=y
CONFIG_NETFILTER_XT_MATCH_IPRANGE=y
CONFIG_NETFILTER_XT_MATCH_LENGTH=y
CONFIG_NETFILTER_XT_MATCH_LIMIT=y
CONFIG_NETFILTER_XT_MATCH_MAC=y
CONFIG_NETFILTER_XT_MATCH_MARK=y
CONFIG_NETFILTER_XT_MATCH_POLICY=y
CONFIG_NETFILTER_XT_MATCH_PKTTYPE=y
CONFIG_NETFILTER_XT_MATCH_QUOTA=y
CONFIG_NETFILTER_XT_MATCH_SOCKET=y
CONFIG_NETFILTER_XT_MATCH_STATE=y
CONFIG_NETFILTER_XT_MATCH_STATISTIC=y
CONFIG_NETFILTER_XT_MATCH_STRING=y
CONFIG_NETFILTER_XT_MATCH_TIME=y
CONFIG_NETFILTER_XT_MATCH_U32=y
CONFIG_IP_NF_IPTABLES=y
CONFIG_IP_NF_MATCH_AH=y
CONFIG_IP_NF_MATCH_ECN=y
CONFIG_IP_NF_MATCH_TTL=y
CONFIG_IP_NF_FILTER=y
CONFIG_IP_NF_TARGET_REJECT=y
CONFIG_IP_NF_NAT=y
CONFIG_IP_NF_TARGET_MASQUERADE=y
CONFIG_IP_NF_TARGET_NETMAP=y
CONFIG_IP_NF_TARGET_REDIRECT=y
CONFIG_IP_NF_MANGLE=y
CONFIG_IP_NF_RAW=y
CONFIG_IP_NF_SECURITY=y
CONFIG_IP_NF_ARPTABLES=y
CONFIG_IP_NF_ARPFILTER=y
CONFIG_IP_NF_ARP_MANGLE=y
CONFIG_IP6_NF_IPTABLES=y
CONFIG_IP6_NF_FILTER=y
CONFIG_IP6_NF_TARGET_REJECT=y
CONFIG_IP6_NF_MANGLE=y
CONFIG_IP6_NF_RAW=y
CONFIG_NET_SCHED=y
CONFIG_NET_SCH_HTB=y
CONFIG_NET_CLS_U32=y
CONFIG_NET_EMATCH=y
CONFIG_NET_EMATCH_U32=y
CONFIG_NET_CLS_ACT=y
CONFIG_BT=y
CONFIG_BT_HCIUART=y
CONFIG_BT_HCIUART_H4=y
CONFIG_CFG80211=y
CONFIG_NL80211_TESTMODE=y
CONFIG_CFG80211_WEXT=y
CONFIG_MAC80211=y
CONFIG_RFKILL=y
CONFIG_UEVENT_HELPER=y
CONFIG_UEVENT_HELPER_PATH="/sbin/hotplug"
CONFIG_DEVTMPFS=y
CONFIG_DEVTMPFS_MOUNT=y
# CONFIG_FW_CACHE is not set
CONFIG_ARM_SCPI_PROTOCOL=y
CONFIG_MTD=y
CONFIG_MTD_BLOCK=y
CONFIG_MTD_RAW_NAND=y
CONFIG_MTD_UBI=y
CONFIG_OF_OVERLAY=y
CONFIG_ZRAM=y
CONFIG_BLK_DEV_LOOP=y
CONFIG_BLK_DEV_RAM=y
CONFIG_BLK_DEV_RAM_SIZE=8192
CONFIG_SRAM=y
CONFIG_SCSI=y
CONFIG_BLK_DEV_SD=y
CONFIG_NETDEVICES=y
CONFIG_TUN=y
# CONFIG_NET_VENDOR_ALACRITECH is not set
# CONFIG_NET_VENDOR_AMAZON is not set
# CONFIG_NET_VENDOR_AMD is not set
# CONFIG_NET_VENDOR_AQUANTIA is not set
# CONFIG_NET_VENDOR_ARC is not set
# CONFIG_NET_VENDOR_BROADCOM is not set
# CONFIG_NET_VENDOR_CADENCE is not set
# CONFIG_NET_VENDOR_CAVIUM is not set
# CONFIG_NET_VENDOR_CORTINA is not set
# CONFIG_NET_VENDOR_EZCHIP is not set
# CONFIG_NET_VENDOR_GOOGLE is not set
# CONFIG_NET_VENDOR_HISILICON is not set
# CONFIG_NET_VENDOR_HUAWEI is not set
# CONFIG_NET_VENDOR_INTEL is not set
# CONFIG_NET_VENDOR_MARVELL is not set
# CONFIG_NET_VENDOR_MICREL is not set
# CONFIG_NET_VENDOR_MICROCHIP is not set
# CONFIG_NET_VENDOR_MICROSEMI is not set
# CONFIG_NET_VENDOR_NI is not set
# CONFIG_NET_VENDOR_NATSEMI is not set
# CONFIG_NET_VENDOR_NETRONOME is not set
# CONFIG_NET_VENDOR_PENSANDO is not set
# CONFIG_NET_VENDOR_QUALCOMM is not set
# CONFIG_NET_VENDOR_RENESAS is not set
# CONFIG_NET_VENDOR_ROCKER is not set
# CONFIG_NET_VENDOR_SAMSUNG is not set
# CONFIG_NET_VENDOR_SEEQ is not set
# CONFIG_NET_VENDOR_SOLARFLARE is not set
# CONFIG_NET_VENDOR_SMSC is not set
# CONFIG_NET_VENDOR_SOCIONEXT is not set
CONFIG_STMMAC_ETH=m
CONFIG_DWMAC_DWC_QOS_ETH=m
# CONFIG_DWMAC_GENERIC is not set
CONFIG_DWMAC_MESON=m
CONFIG_AMLOGIC_ETH_PRIVE=m
# CONFIG_NET_VENDOR_SYNOPSYS is not set
# CONFIG_NET_VENDOR_VIA is not set
# CONFIG_NET_VENDOR_WIZNET is not set
# CONFIG_NET_VENDOR_XILINX is not set
CONFIG_REALTEK_PHY=m
CONFIG_PPP=y
CONFIG_PPP_BSDCOMP=y
CONFIG_PPP_DEFLATE=y
CONFIG_PPP_MPPE=y
CONFIG_USB_USBNET=y
CONFIG_USB_NET_RNDIS_HOST=y
# CONFIG_WLAN is not set
CONFIG_INPUT_EVDEV=y
# CONFIG_INPUT_KEYBOARD is not set
# CONFIG_INPUT_MOUSE is not set
CONFIG_INPUT_MISC=y
CONFIG_INPUT_UINPUT=y
# CONFIG_SERIO_SERPORT is not set
CONFIG_SERIO_LIBPS2=y
# CONFIG_LEGACY_PTYS is not set
CONFIG_SERIAL_DEV_BUS=y
CONFIG_HW_RANDOM=y
CONFIG_I2C_CHARDEV=y
CONFIG_SPI=y
CONFIG_SPI_MEM=y
CONFIG_SPI_SPIDEV=y
CONFIG_PINCTRL=y
CONFIG_PINCTRL_SINGLE=y
CONFIG_GPIOLIB=y
CONFIG_GPIO_SYSFS=y
CONFIG_POWER_RESET_SYSCON=y
CONFIG_POWER_RESET_SYSCON_POWEROFF=y
CONFIG_SYSCON_REBOOT_MODE=y
# CONFIG_HWMON is not set
CONFIG_THERMAL=y
CONFIG_THERMAL_WRITABLE_TRIPS=y
CONFIG_THERMAL_DEFAULT_GOV_POWER_ALLOCATOR=y
CONFIG_THERMAL_GOV_POWER_ALLOCATOR=y
CONFIG_CPU_THERMAL=y
CONFIG_THERMAL_EMULATION=y
CONFIG_WATCHDOG=y
CONFIG_WATCHDOG_CORE=y
CONFIG_WATCHDOG_SYSFS=y
CONFIG_REGULATOR=y
CONFIG_REGULATOR_FIXED_VOLTAGE=y
CONFIG_REGULATOR_GPIO=y
CONFIG_REGULATOR_PWM=m
CONFIG_REGULATOR_VCTRL=y
CONFIG_MEDIA_SUPPORT=y
CONFIG_MEDIA_SUPPORT_FILTER=y
CONFIG_MEDIA_CAMERA_SUPPORT=y
CONFIG_MEDIA_DIGITAL_TV_SUPPORT=y
CONFIG_VIDEO_V4L2_SUBDEV_API=y
CONFIG_MEDIA_USB_SUPPORT=y
CONFIG_FB=y
CONFIG_BACKLIGHT_CLASS_DEVICE=y
CONFIG_SOUND=y
CONFIG_SND=y
CONFIG_SND_SOC=y
CONFIG_USB=y
CONFIG_USB_OTG=y
CONFIG_USB_XHCI_HCD=y
CONFIG_USB_STORAGE=y
CONFIG_USB_UAS=y
CONFIG_USB_DWC3=m
CONFIG_USB_DWC3_HOST=y
CONFIG_USB_GADGET=y
CONFIG_USB_CONFIGFS=y
CONFIG_USB_CONFIGFS_UEVENT=y
CONFIG_USB_CONFIGFS_RNDIS=y
CONFIG_USB_CONFIGFS_MASS_STORAGE=y
CONFIG_USB_CONFIGFS_F_FS=y
CONFIG_MMC=y
CONFIG_MMC_BLOCK_MINORS=32
CONFIG_MMC_SDHCI=y
CONFIG_NEW_LEDS=y
CONFIG_LEDS_CLASS=y
CONFIG_LEDS_GPIO=y
CONFIG_LEDS_PWM=y
CONFIG_LEDS_TRIGGERS=y
CONFIG_LEDS_TRIGGER_TIMER=y
CONFIG_LEDS_TRIGGER_ONESHOT=y
CONFIG_RTC_CLASS=y
CONFIG_RTC_DRV_PCF8563=y
CONFIG_DMADEVICES=y
CONFIG_SYNC_FILE=y
CONFIG_DMABUF_HEAPS=y
CONFIG_DMABUF_SYSFS_STATS=y
CONFIG_DMABUF_HEAPS_DEFERRED_FREE=y
CONFIG_DMABUF_HEAPS_PAGE_POOL=y
CONFIG_DMABUF_HEAPS_SYSTEM=m
CONFIG_UIO=y
# CONFIG_VIRTIO_MENU is not set
# CONFIG_VHOST_MENU is not set
CONFIG_STAGING=y
CONFIG_HWSPINLOCK=y
# CONFIG_FSL_ERRATUM_A008585 is not set
# CONFIG_HISILICON_ERRATUM_161010101 is not set
CONFIG_MAILBOX=y
# CONFIG_IOMMU_SUPPORT is not set
CONFIG_PM_DEVFREQ=y
CONFIG_DEVFREQ_GOV_SIMPLE_ONDEMAND=y
CONFIG_IIO=y
CONFIG_IIO_BUFFER=y
CONFIG_PWM=y
CONFIG_ANDROID=y
CONFIG_ANDROID_VENDOR_HOOKS=y
CONFIG_AMLOGIC_DRIVER=y
CONFIG_AMLOGIC_BREAK_GKI_20=y
CONFIG_AMLOGIC_BREAK_GKI=y
CONFIG_AMLOGIC_MODIFY=y
CONFIG_AMLOGIC_IN_KERNEL_MODULES=y
CONFIG_AMLOGIC_SERIAL_MESON=y
CONFIG_AMLOGIC_SERIAL_MESON_CONSOLE=y
CONFIG_AMLOGIC_COMMON_CLK=m
CONFIG_AMLOGIC_COMMON_CLK_MESON_REGMAP=y
CONFIG_AMLOGIC_COMMON_CLK_MESON_DUALDIV=y
CONFIG_AMLOGIC_COMMON_CLK_MESON_MPLL=y
CONFIG_AMLOGIC_COMMON_CLK_MESON_PHASE=y
CONFIG_AMLOGIC_COMMON_CLK_MESON_PLL=y
CONFIG_AMLOGIC_COMMON_CLK_MESON_SCLK_DIV=y
CONFIG_AMLOGIC_COMMON_CLK_MESON_VID_PLL_DIV=y
CONFIG_AMLOGIC_COMMON_CLK_MESON_AO_CLKC=y
CONFIG_AMLOGIC_COMMON_CLK_MESON_EE_CLKC=y
CONFIG_AMLOGIC_COMMON_CLK_MESON_CPU_DYNDIV=y
CONFIG_AMLOGIC_MESON_CLK_MEASURE=y
CONFIG_AMLOGIC_CLK_DEBUG=y
CONFIG_AMLOGIC_COMMON_CLK_C2=m
CONFIG_AMLOGIC_COMMON_CLK_C3=m
CONFIG_AMLOGIC_COMMON_CLK_A1=m
CONFIG_AMLOGIC_SECMON=m
CONFIG_AMLOGIC_MEDIA_MODULE=m
CONFIG_AMLOGIC_MEDIA_ENABLE=y
CONFIG_AMLOGIC_MEDIA_COMMON=y
CONFIG_AMLOGIC_MEDIA_DRIVERS=y
CONFIG_AMLOGIC_MEDIA_CANVAS=y
CONFIG_AMLOGIC_MEDIA_GE2D=y
CONFIG_AMLOGIC_ION_DEV=y
CONFIG_AMLOGIC_ION=y
CONFIG_AMLOGIC_ION_SYSTEM_HEAP=y
CONFIG_AMLOGIC_VPU=y
CONFIG_AMLOGIC_MEDIA_RDMA=y
CONFIG_AMLOGIC_MEDIA_VSYNC_RDMA=y
CONFIG_AMLOGIC_MEDIA_VFM=y
CONFIG_AMLOGIC_MEDIA_CODEC_MM=y
CONFIG_AMLOGIC_VOUT=y
CONFIG_AMLOGIC_VOUT_CLK_SERVE=y
CONFIG_AMLOGIC_VOUT_SERVE=y
CONFIG_AMLOGIC_LCD=y
CONFIG_AMLOGIC_LCD_TABLET=y
CONFIG_AMLOGIC_BACKLIGHT=y
CONFIG_AMLOGIC_BL_EXTERN=y
CONFIG_AMLOGIC_LCD_EXTERN=y
CONFIG_AMLOGIC_PERIPHERAL_LCD=y
CONFIG_AMLOGIC_MEDIA_CAMERA=y
CONFIG_AMLOGIC_MEDIA_VIDEO=y
CONFIG_AMLOGIC_MEDIA_FB=y
CONFIG_AMLOGIC_MEDIA_FB_OSD_VSYNC_RDMA=y
CONFIG_AMLOGIC_MEDIA_FB_OSD2_ENABLE=y
CONFIG_AMLOGIC_MEDIA_FB_OSD2_CURSOR=y
CONFIG_AMLOGIC_MEDIA_VIDEO_PROCESSOR=y
CONFIG_AMLOGIC_PIC_DEC=y
CONFIG_AMLOGIC_MEDIA_GDC=y
CONFIG_AMLOGIC_POWER=m
CONFIG_AMLOGIC_CPU_INFO=m
CONFIG_AMLOGIC_SHOW_CPU_CHIPID=y
CONFIG_AMLOGIC_PM=m
CONFIG_AMLOGIC_GX_REBOOT=y
CONFIG_AMLOGIC_GPIO=m
CONFIG_AMLOGIC_GPIOLIB=y
CONFIG_AMLOGIC_MESON_IRQ_GPIO=y
CONFIG_AMLOGIC_PINCTRL_MESON=y
CONFIG_AMLOGIC_PINCTRL_MESON_C2=m
CONFIG_AMLOGIC_PINCTRL_MESON_C3=m
CONFIG_AMLOGIC_PINCTRL_MESON_A1=m
CONFIG_AMLOGIC_INPUT=m
CONFIG_AMLOGIC_GPIO_KEY=y
CONFIG_AMLOGIC_ADC_KEYPADS=y
CONFIG_AMLOGIC_MESON_IR=y
CONFIG_AMLOGIC_I2C_MESON=m
CONFIG_AMLOGIC_SPI=m
CONFIG_AMLOGIC_SPI_MESON_SPICC=y
CONFIG_AMLOGIC_SPI_MESON_SPIFC_V2=m
CONFIG_AMLOGIC_TEE=m
CONFIG_AML_TEE=m
CONFIG_AML_OPTEE=m
CONFIG_AMLOGIC_GKI_TOOL=m
CONFIG_AMLOGIC_PWM_MESON=m
CONFIG_AMLOGIC_MESON_CPUFREQ=m
CONFIG_AMLOGIC_EFUSE_UNIFYKEY=m
CONFIG_AMLOGIC_EFUSE=y
CONFIG_AMLOGIC_UNIFYKEY=y
CONFIG_AMLOGIC_EFUSE_BURN=y
CONFIG_AMLOGIC_MHU_MBOX=m
CONFIG_AMLOGIC_JTAG_MESON=m
CONFIG_AMLOGIC_ARM_SMC_WATCHDOG=y
CONFIG_AMLOGIC_MEMORY_EXTEND=y
CONFIG_AMLOGIC_PAGE_TRACE=y
CONFIG_AMLOGIC_SLAB_TRACE=y
CONFIG_AMLOGIC_CMA=y
CONFIG_AMLOGIC_MEM_DEBUG=y
CONFIG_AMLOGIC_STACKPROTECTOR=y
CONFIG_AMLOGIC_VMAP=y
CONFIG_AMLOGIC_USER_FAULT=y
CONFIG_AMLOGIC_MEMORY_DEBUG=m
CONFIG_AMLOGIC_FILE_CACHE=y
CONFIG_AMLOGIC_WATCHPOINT=y
CONFIG_AMLOGIC_REG_ACCESS=y
CONFIG_AMLOGIC_DDR_TOOL=y
CONFIG_AMLOGIC_DDR_BANDWIDTH=y
CONFIG_AMLOGIC_DDR_BANDWIDTH_G12=y
CONFIG_AMLOGIC_DDR_BANDWIDTH_A1=y
CONFIG_AMLOGIC_DMC_MONITOR=y
CONFIG_AMLOGIC_DMC_DEV_ACCESS=y
CONFIG_AMLOGIC_DMC_MONITOR_C2=y
CONFIG_AMLOGIC_MESON_SARADC=m
CONFIG_AMLOGIC_IIO_KFIFO_BUF=y
CONFIG_AMLOGIC_HW_RANDOM_MESON=m
CONFIG_AMLOGIC_RESET_MESON=m
CONFIG_AMLOGIC_RTC=m
CONFIG_AMLOGIC_RTC_DRV_MESON_VRTC=y
CONFIG_AMLOGIC_MESON_RTC=y
CONFIG_AMLOGIC_IRBLASTER=m
CONFIG_AMLOGIC_AMLOGIC_THERMAL=m
CONFIG_AMLOGIC_COOLDEV=y
CONFIG_AMLOGIC_CPUCORE_THERMAL=y
CONFIG_AMLOGIC_GPU_THERMAL=y
CONFIG_AMLOGIC_GPUCORE_THERMAL=y
CONFIG_AMLOGIC_DDR_THERMAL=y
CONFIG_AMLOGIC_MMC_MESON_GX=m
CONFIG_AMLOGIC_HIFI4DSP=m
CONFIG_AMLOGIC_DEBUG=y
CONFIG_AMLOGIC_BGKI_DEBUG_MISC=y
CONFIG_AMLOGIC_DEBUG_ATRACE=y
CONFIG_AMLOGIC_BOOT_TIME=y
CONFIG_AMLOGIC_DEBUG_PRINTK=y
CONFIG_AMLOGIC_BGKI_DEBUG_IOTRACE=y
CONFIG_AMLOGIC_DEBUG_FILE=y
CONFIG_AMLOGIC_FREERTOS=y
CONFIG_AMLOGIC_AUTO_CAPTURE=y
CONFIG_AMLOGIC_USB=y
CONFIG_AMLOGIC_COMMON_USB=y
CONFIG_AMLOGIC_USB_SUPPORT=m
CONFIG_AMLOGIC_USB_DWC_OTG_HCD=m
CONFIG_AMLOGIC_CRG=y
CONFIG_AMLOGIC_USBPHY=y
CONFIG_AMLOGIC_USB2PHY=y
CONFIG_AMLOGIC_USB3PHY=y
CONFIG_AMLOGIC_USBPHYC2=y
CONFIG_AMLOGIC_BC=y
CONFIG_AMLOGIC_CC=y
CONFIG_AMLOGIC_CRYPTO_DMA=m
CONFIG_AMLOGIC_WIRELESS=m
CONFIG_AMLOGIC_BLUETOOTH=y
CONFIG_AMLOGIC_WIFI=y
CONFIG_AMLOGIC_MDIO_G12A=m
CONFIG_AMLOGIC_INPHY=m
CONFIG_AMLOGIC_MTD_SPI_NAND=m
CONFIG_AMLOGIC_MTD_NAND=m
CONFIG_AMLOGIC_MTD_COMMON=m
CONFIG_AMLOGIC_MTD_RESV=m
CONFIG_AMLOGIC_DVB_CONFIG=m
CONFIG_AMLOGIC_DVB_EXTERN=y
CONFIG_AMLOGIC_DVB_DSM=y
CONFIG_AMLOGIC_DVB_COMPAT=y
CONFIG_AMLOGIC_AUCPU=y
CONFIG_AMLOGIC_SMARTCARD=y
CONFIG_AMLOGIC_DVB_DMX=m
CONFIG_AMLOGIC_SND_SOC=m
CONFIG_AMLOGIC_SND_SOC_AUGE=y
CONFIG_AMLOGIC_SND_SOC_COMMON=y
CONFIG_AMLOGIC_AMAUDIO=y
CONFIG_AMLOGIC_AUDIO_DSP=y
CONFIG_AMLOGIC_AUDIO_INFO=y
CONFIG_AMLOGIC_SND_SOC_CODECS=y
CONFIG_AMLOGIC_SND_CODEC_DUMMY_CODEC=m
CONFIG_AMLOGIC_SND_CODEC_AMLT9015=m
CONFIG_AMLOGIC_SND_CODEC_A1_ACODEC=m
CONFIG_AMLOGIC_SND_SOC_TLV320ADC3101=m
CONFIG_AMLOGIC_SND_SOC_AD82584F=m
CONFIG_EXT4_FS=y
CONFIG_EXT4_FS_SECURITY=y
CONFIG_OVERLAY_FS=y
CONFIG_MSDOS_FS=y
CONFIG_VFAT_FS=y
CONFIG_EXFAT_FS=y
CONFIG_TMPFS=y
CONFIG_TMPFS_POSIX_ACL=y
CONFIG_UBIFS_FS=y
CONFIG_PSTORE=y
CONFIG_PSTORE_CONSOLE=y
CONFIG_PSTORE_RAM=y
# CONFIG_NETWORK_FILESYSTEMS is not set
CONFIG_NLS_CODEPAGE_437=y
CONFIG_NLS_ISO8859_1=y
CONFIG_SECURITY=y
CONFIG_SECURITY_NETWORK=y
CONFIG_HARDENED_USERCOPY=y
CONFIG_LSM="lockdown,yama,loadpin,safesetid,integrity,selinux,smack,tomoyo,apparmor,bpf"
CONFIG_CRYPTO_CTS=y
CONFIG_CRYPTO_XTS=y
CONFIG_CRYPTO_DES=y
# CONFIG_CRYPTO_HW is not set
CONFIG_XZ_DEC=y
# CONFIG_XZ_DEC_X86 is not set
# CONFIG_XZ_DEC_POWERPC is not set
# CONFIG_XZ_DEC_IA64 is not set
# CONFIG_XZ_DEC_ARM is not set
# CONFIG_XZ_DEC_ARMTHUMB is not set
# CONFIG_XZ_DEC_SPARC is not set
CONFIG_DMA_CMA=y
CONFIG_CMA_SIZE_MBYTES=8
CONFIG_CMA_ALIGNMENT=4
CONFIG_PRINTK_TIME=y
CONFIG_PRINTK_CALLER=y
# CONFIG_SYMBOLIC_ERRNAME is not set
CONFIG_DEBUG_INFO=y
CONFIG_DEBUG_SECTION_MISMATCH=y
# CONFIG_SECTION_MISMATCH_WARN_ONLY is not set
CONFIG_MAGIC_SYSRQ=y
CONFIG_MAGIC_SYSRQ_SERIAL_SEQUENCE="axbxcx"
CONFIG_DEBUG_FS=y
CONFIG_DEBUG_WX=y
CONFIG_SCHED_STACK_END_CHECK=y
CONFIG_DEBUG_SHIRQ=y
CONFIG_PANIC_ON_OOPS=y
CONFIG_PANIC_TIMEOUT=5
CONFIG_SOFTLOCKUP_DETECTOR=y
CONFIG_BOOTPARAM_SOFTLOCKUP_PANIC=y
CONFIG_WQ_WATCHDOG=y
# CONFIG_DEBUG_PREEMPT is not set
CONFIG_DEBUG_ATOMIC_SLEEP=y
CONFIG_BUG_ON_DATA_CORRUPTION=y
# CONFIG_RCU_TRACE is not set
CONFIG_CPU_HOTPLUG_STATE_CONTROL=y
CONFIG_FUNCTION_TRACER=y
# CONFIG_FUNCTION_GRAPH_TRACER is not set
CONFIG_FTRACE_SYSCALLS=y
# CONFIG_STRICT_DEVMEM is not set
# CONFIG_RUNTIME_TESTING_MENU is not set
```
