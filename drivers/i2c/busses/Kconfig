## drivers/media/common/v4l_util/Kconfig
```kconfig
# SPDX-License-Identifier: (GPL-2.0+ OR MIT)
#
# V4L UTIL configuration
#

config AMLOGIC_VIDEOBUF_RESOURCE
	bool "Amlogic V4L UTIL Support"
	select VIDEOBUF2_DMA_CONTIG
	select VIDEOBUF2_DMA_SG
	select V4L2_MEM2MEM_DEV
	default n
	help
		Select to enable V4L UTIL support

config AMLOGIC_MEDIA_V4L2
	bool "Amlogic Modify V4L2 In Kernel Support"
	depends on AMLOGIC_BREAK_GKI
	default n
	help
		Select to enable AMLOGIC V4L2 support
```

## drivers/media/common/vfm/Kconfig
```kconfig
# SPDX-License-Identifier: (GPL-2.0+ OR MIT)
#
# VFM configuration
#

config AMLOGIC_MEDIA_VFM
	tristate "Amlogic VFM Support"
	default n
	help
		Select to enable VFM support
```

## drivers/media/dtv_demod/Kconfig
```kconfig
# SPDX-License-Identifier: (GPL-2.0+ OR MIT)
#
# DTV driver configuration
#

menu "Amlogic DTV driver"

config AMLOGIC_DTV_DEMOD
	tristate "Amlogic DTVDEMOD device driver"
	default n
	help
		DTVDEMOD device driver.
		Y: enable
		N: disable
		M: build as module

endmenu
```

## drivers/media/enhancement/Kconfig
```kconfig
# SPDX-License-Identifier: (GPL-2.0+ OR MIT)
#
# Amlogic multimedia input configuration
#
menu "Amlogic Enhancement drivers"
config AMLOGIC_MEDIA_ENHANCEMENT
	bool "Amlogic driver of enhancement"
	depends on AMLOGIC_MEDIA_DRIVERS
	default n
	help
	  Amlogic media enhancement support.
	  Media enhancement module includes amvecm amdolby_vision amprime_sl etc.

if AMLOGIC_MEDIA_ENHANCEMENT
source "$(COMMON_DRIVERS_DIR)/drivers/media/enhancement/amdolby_vision/Kconfig"
source "$(COMMON_DRIVERS_DIR)/drivers/media/enhancement/amvecm/Kconfig"
#source "$(COMMON_DRIVERS_DIR)/drivers/media/enhancement/amprime_sl/Kconfig"
endif

endmenu
```
