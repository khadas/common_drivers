## drivers/memory_ext/Kconfig
```kconfig
# SPDX-License-Identifier: (GPL-2.0+ OR MIT)

menuconfig AMLOGIC_MEMORY_EXTEND
	bool "AMLOGIC memory extend support"
	depends on AMLOGIC_DRIVER
	depends on AMLOGIC_BREAK_GKI
	default n
	help
		Amlogic memory extend is drivers which extend for memory management
		functions, can be used for memory debug or other features.

config AMLOGIC_PAGE_TRACE
	bool "Amlogic trace for page allocate"
	depends on AMLOGIC_MEMORY_EXTEND
	depends on KALLSYMS
	depends on !NUMA_BALANCING
	default n
	help
		Amlogic page trace will record function address of caller for page
		allocate/free, according with allocate flags and order. trace
		information is stored in a pre-allocated memory block. And can be shown
		with allocate page count information of each caller functions from
		/proc/pagetrace

config AMLOGIC_PAGE_TRACE_INLINE
	bool "page trace ininle into page flags"
	depends on AMLOGIC_PAGE_TRACE
	depends on 64BIT
	depends on !KASAN_HW_TAGS && !KASAN_SW_TAGS
	default n
	help
		This feature enable to inline page trace into high 32bits of
		page->flags on 64 bit kernel. Because other total page flags
		are less than 32bit, so It can help to save memory when
		use page trace. But it conflict with KASAN tags, so when kasan
		tags enabled, this feature will be auto disabled

config AMLOGIC_SLAB_TRACE
	bool "Amlogic trace for slab usage"
	depends on SLUB
	depends on AMLOGIC_MEMORY_EXTEND
	default n
	help
		Amlogic slab trace will record function address of caller for
		slab allocate/free(kmalloc-xxxx only). trace information is
		stored in rb tree. And can be shown with allocate size
		information of each caller functions from /proc/slabtrace

config AMLOGIC_CMA
	bool "Amlogic CMA change"
	depends on AMLOGIC_MEMORY_EXTEND
	depends on CMA
	default n
	help
		Amlogic CMA optimization for cma alloc/free problems
		Including policy change of CMA usage

config AMLOGIC_MEM_DEBUG
	bool "Amlogic debug mem"
	depends on AMLOGIC_MEMORY_EXTEND
	default n
	help
		Memory debug which hacking to kernel mm source.

config AMLOGIC_STACKPROTECTOR
	bool "Amlogic stack protector"
	depends on AMLOGIC_MEMORY_EXTEND
	default n
	help
		This config is used to disable CONFIG_STACKPROTECTOR
		if enabled AMLOGIC_VMAP. CONFIG_STACKPROTECTOR have
		bad effect to save stack usage.

config AMLOGIC_VMAP
	bool "Amlogic kernel stack"
	depends on AMLOGIC_MEMORY_EXTEND
	depends on AMLOGIC_STACKPROTECTOR
	default n
	help
		This config is used to enable amlogic kernel stack
		usage optimization with vmalloc. It depends on
		AMLOGIC_MEMORY_EXTEND. This config only opened
		on 64 bit platform.

config AMLOGIC_USER_FAULT
	bool "Amlogic user fault helper"
	depends on AMLOGIC_MEMORY_EXTEND
	default n
	help
		show more information when catch user fault. Including:
		memory around all registers
		maps with pc/lr
		pfn for all virtual address of regirsters

config AMLOGIC_ZSTD
	tristate "Amlogic zstd optimize"
	depends on AMLOGIC_MEMORY_EXTEND
	default n
	help
		This config is an optimization of zstd,
		in zram, to improve the compression ratio
		and save memory

config AMLOGIC_MEMORY_STAT
	bool "Amlogic stat memory info"
	depends on AMLOGIC_MEMORY_EXTEND
	default n
	help
		This config use to stat memory info,
		include count free pages in migrate
		list, print more memory information.

config AMLOGIC_CMA_DIS
	bool "Amlogic CMA disable change fot gki"
	depends on AMLOGIC_MEMORY_EXTEND
	depends on CMA
	default n
	help
		Amlogic disable CMA optimization for gki needs.

config AMLOGIC_MEMORY_OPT
	bool "Amlogic memory optimization support"
	depends on AMLOGIC_MEMORY_EXTEND
	default n
	help
		Amlogic memory optimization support,
		distinguish from AMLOGIC_MEMORY_EXTEND,
		because of gki requirements, enable in
		aarch32.

config AMLOGIC_PIN_LOCKED_FILE
	bool "Amlogic pin locked file"
	depends on AMLOGIC_MEMORY_EXTEND
	default n
	help
		If we pin a file in android, the whole daa of this
		file will be loaded to DDR, but most of these data
		may not be used, this caused memory waste.
		delay mark mlocked flags for unevictable pages until
		it has been faulted.
```

## drivers/mfd/Kconfig
```kconfig
# SPDX-License-Identifier: (GPL-2.0+ OR MIT)
#
# Multifunction miscellaneous devices
#

menuconfig AMLOGIC_MFD
	tristate "Amlogic mfd devices"
	default n
	help
	  Say Y here, and a list of multifunction drivers will be displayed.
	  Everything that didn't fit into the other categories is here. This option
	  doesn't affect the kernel.

	  If unsure, say Y.

if AMLOGIC_MFD

config AMLOGIC_MFD_PMIC6B
	bool "Amlogic MFD PMIC6B"
	depends on I2C
	select MFD_CORE
	select REGMAP_I2C
	select REGMAP_IRQ
	default n
	help
	  Say yes here to add support for the Amlogic MFD PMIC.
	  This driver provides common support for accessing the device,
	  additional drivers must be enabled in order to use the
	  functionality of the device.

endif
```

## drivers/mmc/Kconfig
```kconfig
# SPDX-License-Identifier: (GPL-2.0+ OR MIT)

source "../common_drivers/drivers/mmc/host/Kconfig"
```

## drivers/mmc/host/Kconfig
```kconfig
# SPDX-License-Identifier: (GPL-2.0+ OR MIT)

config AMLOGIC_MMC_MESON_GX
         tristate "Amlogic S905/GX*/AXG SD/MMC Host Controller support"
         depends on MMC
         help
           This selects support for the Amlogic SD/MMC Host Controller
           found on the S905/GX*/AXG family of SoCs.  This controller is
           MMC 5.1 compliant and supports SD, eMMC and SDIO interfaces.
           If you have a controller with this interface, say Y here.
```

## drivers/mtd/common/Kconfig
```kconfig
# SPDX-License-Identifier: (GPL-2.0+ OR MIT)

config AMLOGIC_MTD_COMMON
	tristate "AMLOGIC MTD common api"
	help
		Meson slc nand and spi nand have many public
		APIS. These public APIs are unified in the
                same Ko.

config AMLOGIC_MTD_RESV
	tristate "AMLOGIC MTD reserve area management"
	help
		Implements a reserve area which is used
		to manage the bbt/key/dtd/env and so on.
		we pre-allocate fixed blocks and list these
		blocks base on different usage, such as bbt,
		key. it is efficiently for power lost and
		backups and others.

config AMLOGIC_NAND
	bool "Amlogic NAND modification"
	default n
	depends on MTD_BLOCK
	depends on AMLOGIC_BREAK_GKI_20
	help
		Add bad block handling for mtd block. some
		filesystems or users don't care the bad blocks
		on raw NAND, so if you want to handle bad blocks
		in mtd block layer, say Y here.
```

## drivers/mtd/nand/Kconfig
```kconfig
# SPDX-License-Identifier: (GPL-2.0+ OR MIT)

config AMLOGIC_MTD_NAND
        tristate "Support for NAND controller on Amlogic's Meson SoCs"
        help
          Enables support for NAND controller on Amlogic's Meson SoCs.
          This controller is found on Meson SoCs.
```

## drivers/mtd/reserve/Kconfig
```kconfig
# SPDX-License-Identifier: (GPL-2.0+ OR MIT)

config AMLOGIC_MTD_RESV
	tristate "AMLOGIC MTD reserve area management"
	help
		Implements a reserve area which is used
		to manage the bbt/key/dtd/env and so on.
		we pre-allocate fixed blocks and list these
		blocks base on different usage, such as bbt,
		key. it is efficiently for power lost and
		backups and others.
```

## drivers/mtd/spinand/Kconfig
```kconfig
# SPDX-License-Identifier: (GPL-2.0+ OR MIT)

config AMLOGIC_MTD_SPI_NAND
        tristate "AMLOGIC SPI NAND support"
        default n
        help
          This is based on MTD_SPI_NAND, adding partition and rsv management.
          Say Y, Will register partitions according to dts and add rsv
          management.
          Say N, Only register one mtd device.
```

## drivers/net/Kconfig
```kconfig
# SPDX-License-Identifier: (GPL-2.0+ OR MIT)

source "$(COMMON_DRIVERS_DIR)/drivers/net/mdio/Kconfig"
source "$(COMMON_DRIVERS_DIR)/drivers/net/phy/Kconfig"
source "$(COMMON_DRIVERS_DIR)/drivers/net/ethernet/Kconfig"
```

## drivers/net/bluetooth/Kconfig
```kconfig
# SPDX-License-Identifier: (GPL-2.0+ OR MIT)

config AMLOGIC_LINUX_BT_SMP
	bool "Amlogic kernel 5.15 for smp"
	depends on AMLOGIC_BREAK_GKI
	default n
	help
	  kernel 5.15 JUST_WORKS no need user confirm

config AMLOGIC_LINUX_BT_SUPPORT_WAKEUP
	bool "Support BT deep sleep wake-up"
	depends on AMLOGIC_BREAK_GKI
	depends on BT
	default n
	help
	  This configuration is used to control the sleep wake-up function
	  of BT under kernel 5.15 in Linux systems.
```

## drivers/net/ethernet/stmicro/Kconfig
```kconfig
# SPDX-License-Identifier: (GPL-2.0+ OR MIT)

source "$(COMMON_DRIVERS_DIR)/drivers/net/ethernet/stmicro/stmmac/Kconfig"
```

## drivers/net/ethernet/stmicro/stmmac/Kconfig
```kconfig
# SPDX-License-Identifier: (GPL-2.0+ OR MIT)

config AMLOGIC_ETH_PRIVE
	tristate "Amlogic PHY debug"
	help
	  Currently has a driver for the Amlogic PHY debug
```

## drivers/net/mdio/Kconfig
```kconfig
# SPDX-License-Identifier: (GPL-2.0+ OR MIT)

config AMLOGIC_MDIO_G12A
        tristate "Amlogic mdio mux g12a"
	depends on OF_MDIO && HAS_IOMEM && COMMON_CLK
	select MDIO_BUS_MUX
	default n
        help
          Say Y here if you want to use the
	  amlogic internal phy.
```

## drivers/net/phy/Kconfig
```kconfig
# SPDX-License-Identifier: (GPL-2.0+ OR MIT)

config AMLOGIC_INPHY
	tristate "Amlogic Meson GXL Internal PHY"
	help
	  Currently has a driver for the Amlogic Meson GXL Internal PHY
```

## drivers/pci/Kconfig
```kconfig
# SPDX-License-Identifier: (GPL-2.0+ OR MIT)

menu "Amlogic PCI Support"

config AMLOGIC_PCI_HOST
	bool "Amlogic PCI controller support"
	default n
	help
	  Amlogic PCI controller drivers support

config AMLOGIC_PCI_EP
	bool "Amlogic PCI endpoint support"
	default n
	help
	  Amlogic PCI endpoint drivers support

source "$(COMMON_DRIVERS_DIR)/drivers/pci/controller/Kconfig"

endmenu
```

## drivers/pci/controller/Kconfig
```kconfig
# SPDX-License-Identifier: GPL-2.0-only

config AMLOGIC_PCIE_V2_HOST
	tristate "Meson PCIE_V2 controller"
	depends on AMLOGIC_PCI_HOST
	depends on PCI && PCI_MSI_IRQ_DOMAIN
	depends on PCIE_DW_HOST
	help
	  Say Y here if you want to enable PCIE controller support on Amlogic
	  SoCs. The PCIE controller on Amlogic is based on DesignWare hardware
	  and therefore the driver re-uses the DesignWare core functions to
	  implement the driver.
```

## drivers/pinctrl/Kconfig
```kconfig
# SPDX-License-Identifier: (GPL-2.0+ OR MIT)

source "$(COMMON_DRIVERS_DIR)/drivers/pinctrl/meson/Kconfig"
```

## drivers/pinctrl/meson/Kconfig
```kconfig
# SPDX-License-Identifier: GPL-2.0-only

menuconfig AMLOGIC_PINCTRL_MESON
	tristate "Amlogic SoC pinctrl drivers"
	depends on OF
	depends on PINMUX
	depends on PINCONF
	depends on GENERIC_PINCONF
	depends on GPIOLIB
	depends on OF_GPIO
	depends on REGMAP_MMIO

if AMLOGIC_PINCTRL_MESON
config AMLOGIC_PINCTRL_MESON_S4
	tristate "Meson s4 Soc pinctrl driver"
	default n
	help
	  the chip of s4 will be built
	  when enable this config.
	  s4 pinctrl can work.
	  otherwise s4 pinctrl can't work

endif
```

## drivers/pm/Kconfig
```kconfig
# SPDX-License-Identifier: (GPL-2.0+ OR MIT)

menu "Meson core pm driver"

config AMLOGIC_PM
	tristate "Meson gx chips pm driver"
	default n
	help
	  This is the power related driver

config AMLOGIC_GX_SUSPEND
	bool "Meson gx chips suspend driver"
	depends on AMLOGIC_PM
	depends on CPU_IDLE
	depends on PM_WAKELOCKS
	depends on PM
	depends on ARM64 || ARM
	default n
	help
	  This is the Amlogic suspend driver for 64bit family chips
	  It provides PM suspend entry to ATF. It invoke ATF via idle routine.
	  It support PSCIv0.2 or newer version.

	  If you want this support, you should say Y here.

config AMLOGIC_LEGACY_EARLY_SUSPEND
	bool "A re-implement early_suspend instead of legacy early_suspend."
	depends on AMLOGIC_GX_SUSPEND
	depends on PM
	default n
	help
	  Kernel has abandoned legacy early_suspend mechanism.
	  Here re-implement a early_suspend for use driver
	  legacy early_suspend code easily.

	  If you want this support, you should say Y here.

config AMLOGIC_GX_REBOOT
	bool "Amlogic reboot gx"
	depends on AMLOGIC_PM
	default n
	help
	  This is the Amlogic GX reboot driver.
endmenu
```

## drivers/power/Kconfig
```kconfig
# SPDX-License-Identifier: (GPL-2.0+ OR MIT)

config AMLOGIC_POWER
	tristate "Amlogic power related driver support"
	default n
	select PM_GENERIC_DOMAINS
	help
	  this config enables to use amlogic power management driver
	  Say y here if you want power related driver(pmu/dvfs) support
	  The use of select here is due to the PM_GENERIC_DOMAINS set by gki's QCOM walk

config AMLOGIC_POWER_EE
	bool "Amlogic power domain ee support"
	default y if (AMLOGIC_POWER=m || AMLOGIC_POWER=y)
	depends on AMLOGIC_POWER
	help
	  this config enables to use amlogic ee power management driver


source "$(COMMON_DRIVERS_DIR)/drivers/power/meson_pmic6b/Kconfig"
```

## drivers/power/meson_pmic6b/Kconfig
```kconfig
# SPDX-License-Identifier: (GPL-2.0+ OR MIT)
#
# AMLOGIC_POWER_PMIC drivers configuration
#

menuconfig AMLOGIC_POWER_PMIC
	bool "Amlogic power supply class support"
	default n
	help
	  Say Y here to enable power supply class support. This allows
	  power supply (batteries, AC, USB) monitoring by userspace
	  via sysfs and uevent (if available) and/or APM kernel interface
	  (if selected below).
	  If unsure, say no.

if AMLOGIC_POWER_PMIC

config AMLOGIC_BATTERY_PMIC6B
	bool "Amlogic PMIC6B Fuel Gauge Support"
	depends on REGMAP_I2C
	depends on AMLOGIC_MFD
	depends on AMLOGIC_MFD_PMIC6B
	default n
	help
          Say Y here to enable support for the power management unit
	  provided by the Fuel Gauge driver for the Amlogic PMIC6B.
	  If unsure, say no.
	  This driver can also be built as a module. If so, the module will be
	  called pmic6b-battery.

endif
```

## drivers/pwm/Kconfig
```kconfig
# SPDX-License-Identifier: (GPL-2.0+ OR MIT)

config AMLOGIC_PWM
	tristate "Amlogic PWM Support"
	default n
	depends on COMMON_CLK && HAS_IOMEM
	help
	  amlogic pwm support
	  select y for built-in
	  select m for ko
	  select n for disable
	  This option alone does not add any kernel code.
	  If you say N, all options in this submenu will be
	  skipped and disabled.

config AMLOGIC_PWM_MESON
	bool "Amlogic Meson PWM driver"
	depends on AMLOGIC_PWM
	help
	  The platform driver for Amlogic Meson PWM controller.

config AMLOGIC_PWM_MESON_TEE
	bool "Amlogic Meson PWM TEE driver"
	depends on AMLOGIC_PWM
	help
	  The platform driver for Amlogic Meson PWM TEE controller.
```

## drivers/reboot/Kconfig
```kconfig
# SPDX-License-Identifier: (GPL-2.0+ OR MIT)

# Amlogic POWER OFF
config AMLOGIC_GX_REBOOT
	tristate "Amlogic reboot gx"
	default n
	help
	  This is the Amlogic GX reboot driver.
```

## drivers/regulator/Kconfig
```kconfig
# SPDX-License-Identifier: (GPL-2.0+ OR MIT)

config AMLOGIC_REGULATOR
	tristate "Amlogic regulator devices support"
	default n
	help
	  regulator devices support
	  select y for built-in
	  select m for ko
	  select n for disable

if AMLOGIC_REGULATOR
source "$(COMMON_DRIVERS_DIR)/drivers/regulator/meson_pmic6b/Kconfig"
endif
```
