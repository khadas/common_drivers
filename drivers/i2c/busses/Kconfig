## drivers/i2c/busses/Kconfig
```kconfig
# SPDX-License-Identifier: (GPL-2.0+ OR MIT)

menu "I2C Hardware Bus support"
	depends on HAS_IOMEM

config AMLOGIC_I2C_MESON
	tristate "Amlogic Meson I2C controller"
	help
	  If you say yes to this option, support will be included for the
	  I2C interface on the Amlogic Meson family of SoCs.

endmenu
```

## drivers/iio/Kconfig
```kconfig
# SPDX-License-Identifier: (GPL-2.0+ OR MIT)

if IIO

source "$(COMMON_DRIVERS_DIR)/drivers/iio/adc/Kconfig"

endif # IIO
```

## drivers/iio/adc/Kconfig
```kconfig
# SPDX-License-Identifier: (GPL-2.0+ OR MIT)

menu "Analog to digital converters"

config AMLOGIC_MESON_SARADC
	tristate "Amlogic Meson SAR ADC driver"
	depends on OF && COMMON_CLK
	depends on REGMAP_MMIO
	help
	  Say yes here to build support for the SAR ADC found in Amlogic Meson
	  SoCs.

	  To compile this driver as a module, choose M here: the
	  module will be called meson_saradc.

endmenu
```

## drivers/input/Kconfig
```kconfig
# SPDX-License-Identifier: (GPL-2.0+ OR MIT)

config AMLOGIC_INPUT
	tristate "Amlogic input devices support"
	default n
	help
	  input devices support
	  select y for built-in
	  select m for ko
	  select n for disable

if AMLOGIC_INPUT
source "$(COMMON_DRIVERS_DIR)/drivers/input/keyboard/Kconfig"
source "$(COMMON_DRIVERS_DIR)/drivers/input/ir/Kconfig"
endif
```

## drivers/input/ir/Kconfig
```kconfig
# SPDX-License-Identifier: (GPL-2.0+ OR MIT)

config AMLOGIC_MESON_IR
	bool "Amlogic Meson IR remote control support"
	default n
	help
	  Say Y here if you want to use the Meson IR remote control.
```

## drivers/input/keyboard/Kconfig
```kconfig
# SPDX-License-Identifier: (GPL-2.0+ OR MIT)

config AMLOGIC_GPIO_KEY
	bool "Amlogic gpio key device support"
	default n
	help
	  Say Y here if
	  you want to use
	  the amlogic hold
	  key.

config AMLOGIC_ADC_KEYPADS
	bool "Meson ADC keypad support"
	depends on AMLOGIC_MESON_SARADC
	default n
	help
	  Say Y here if
	  you want to
	  use the Meson ADC
	  keypad.
```

## drivers/input/meson_pmic6b/Kconfig
```kconfig
# SPDX-License-Identifier: (GPL-2.0+ OR MIT)
#
# AMLOGIC_INPUT_PMIC drivers configuration
#

menuconfig AMLOGIC_INPUT_PMIC
	bool "Amlogic misc devices"
	default n
	help
	  Say Y here, and a list of miscellaneous input drivers will be displayed.
	  Everything that didn't fit into the other categories is here. This option
	  doesn't affect the kernel.

	  If unsure, say Y.

if AMLOGIC_INPUT_PMIC

config AMLOGIC_PWRKEY_PMIC6B
	bool "Amlogic PWRKEY PMIC6B"
	depends on REGMAP_I2C
	depends on AMLOGIC_MFD
	depends on AMLOGIC_MFD_PMIC6B
	default n
	help
	  Say yes here to add support for the Amlogic PWRKEY PMIC6B.
	  Say no here to don't add support for the Amlogic PWRKEY PMIC6B.
	  Default is yes, what means add support for the Amlogic PWRKEY PMIC6B.

endif
```

## drivers/jtag/Kconfig
```kconfig
# SPDX-License-Identifier: (GPL-2.0+ OR MIT)

config	AMLOGIC_JTAG_MESON
	tristate "meson jtag setup driver"
	default n
	help
		This option enables support jtag setup.
		Enable this option to allow setup jtag
		with uboot parameter. Ability to debug
		the system using jtag
```

## drivers/led/Kconfig
```kconfig
# SPDX-License-Identifier: (GPL-2.0+ OR MIT)
#
# LED drivers configuration
#

config AMLOGIC_LED
	tristate "Amlogic LED Support"
	default n
	help
	  amlogic led support
	  select y for built-in
	  select m for ko
	  select n for disable
	  This option alone does not add any kernel code.
	  If you say N, all options in this submenu will be
	  skipped and disabled.

if AMLOGIC_LED

config AMLOGIC_LEDS_TLC59116
	bool "LED Support for the TLC59116"
	depends on LEDS_CLASS
	default n
	help
	  Choose this option if you want to use the LED on
	  TLC59116.

config AMLOGIC_LEDS_AW9523B
	bool "LED Support for the AW9523B"
	depends on LEDS_CLASS
	default n
	help
	  Choose this option if you want to use the LED on
	  AW9523B.

config AMLOGIC_LEDS_STATE
	bool "LED state support"
	depends on LEDS_CLASS
	default n
	help
	  Choose this option if you want to use the LED state
	  and led function

config AMLOGIC_LEDS_DCON
	bool "DCON LED support"
	depends on LEDS_CLASS
	default n
	help
	  Choose this option if you want to use the DCON LED
	  and led function

endif
```

## drivers/mailbox/Kconfig
```kconfig
#
# Amlogic mhu mailbox device configuration
#

menu "MESON MHU mailbox Support"

config AMLOGIC_MHU_MBOX
	tristate "MESON MHU Mailbox"
	default n
	depends on MAILBOX
	help
		MESON Mailbox driver.
		.
		.
		.
endmenu
```

## drivers/md/Kconfig
```kconfig
# SPDX-License-Identifier: GPL-2.0-only
#
# Block device driver configuration
#

config AMLOGIC_DM_BOW
	tristate "Backup block device"
	depends on BLK_DEV_DM
	depends on DM_BUFIO
	help
	  This device-mapper target takes a device and keeps a log of all
	  changes using free blocks identified by issuing a trim command.
	  This can then be restored by running a command line utility,
	  or committed by simply replacing the target.

	  If unsure, say N.
```

## drivers/media/Kconfig
```kconfig
# SPDX-License-Identifier: (GPL-2.0+ OR MIT)
#
# Amlogic multimedia configuration
#

menu "Amlogic multimedia configuration"

config AMLOGIC_MEDIA_MODULE
	tristate "Amlogic Multimedia compile support"
	default y
	help
		media module compile support
		select y for built-in
		select m for ko
		select n for disable

config AMLOGIC_MEDIA_ENABLE
	bool "Amlogic Multimedia Support"
	default n
	help
		Amlogic multimedia framework composed of two parts,
		the first part is common which consists of modules
		such as arch, codec_mm, vfm, the second is driver
		part of the media, both of which depends on this
		configuration options.

config AMLOGIC_MEDIA_COMMON
	bool "Amlogic the common of the media"
	depends on AMLOGIC_MEDIA_ENABLE
	default n
	help
		This option is used to configure Amlogic common
		for media, it as the basis for drivers of the
		multimedia, mainly on the operation of the
		registers, memory allocation and the chain of
		responsibility management of the frame processing.

config AMLOGIC_MEDIA_DRIVERS
	bool "Amlogic drivers of the media"
	depends on AMLOGIC_MEDIA_COMMON
	default n
	help
		This option is used to configure Amlogic drivers
		of the multimedia, which consists of video decoder
		module, video decoder management module and post
		processing of the frame.

config AMLOGIC_MEDIA_MULTI_DEC
	bool "Support multi-instance decoding"
	default n
	help
		Support for multi-instance decoding features,
		this option must be configured if multi playback
		is required, the feature supports decoding
		at the same time.

config AMLOGIC_MEDIA_NO_PARSER
	bool "The stream buffer works on non-parser mode."
	depends on AMLOGIC_MEDIA_DRIVERS
	default n
	help
		The module of hardware parser will be removed after
		SC2 platform. therefore the parser modules can't be
		builded in ko if enable this item.

config AMLOGIC_V4L2
	bool "Amlogic V4L2 VENDOR HOORKS"

if AMLOGIC_MEDIA_COMMON
source "$(COMMON_DRIVERS_DIR)/drivers/media/common/Kconfig"
endif

if AMLOGIC_MEDIA_DRIVERS
source "$(COMMON_DRIVERS_DIR)/drivers/media/vout/Kconfig"
source "$(COMMON_DRIVERS_DIR)/drivers/media/camera/Kconfig"
source "$(COMMON_DRIVERS_DIR)/drivers/media/video_sink/Kconfig"
source "$(COMMON_DRIVERS_DIR)/drivers/media/vrr/Kconfig"
source "$(COMMON_DRIVERS_DIR)/drivers/media/osd/Kconfig"
source "$(COMMON_DRIVERS_DIR)/drivers/media/deinterlace/Kconfig"
source "$(COMMON_DRIVERS_DIR)/drivers/media/di_multi/Kconfig"
source "$(COMMON_DRIVERS_DIR)/drivers/media/di_local/Kconfig"
source "$(COMMON_DRIVERS_DIR)/drivers/media/video_processor/Kconfig"
source "$(COMMON_DRIVERS_DIR)/drivers/media/enhancement/Kconfig"
source "$(COMMON_DRIVERS_DIR)/drivers/media/frame_sync/Kconfig"
source "$(COMMON_DRIVERS_DIR)/drivers/media/gdc/Kconfig"
source "$(COMMON_DRIVERS_DIR)/drivers/media/vin/Kconfig"
source "$(COMMON_DRIVERS_DIR)/drivers/media/cec/Kconfig"
source "$(COMMON_DRIVERS_DIR)/drivers/media/esm/Kconfig"
source "$(COMMON_DRIVERS_DIR)/drivers/media/atv_demod/Kconfig"
source "$(COMMON_DRIVERS_DIR)/drivers/media/avsync/Kconfig"
source "$(COMMON_DRIVERS_DIR)/drivers/media/dtv_demod/Kconfig"
source "$(COMMON_DRIVERS_DIR)/drivers/media/frc/Kconfig"
source "$(COMMON_DRIVERS_DIR)/drivers/media/di_v4l/Kconfig"
endif
endmenu
```

## drivers/media/avsync/Kconfig
```kconfig
# SPDX-License-Identifier: (GPL-2.0+ OR MIT)
#
# Amlogic multi-instance AVsync
#
config AMLOGIC_MEDIA_MSYNC
	bool "Multi-Instance AVSync"
	default n
	help
		Amlogic multi instance AVSync support
```

## drivers/media/camera/Kconfig
```kconfig
menu "Amlogic Camera Support"

config AMLOGIC_VIDEO_CAPTURE
	tristate "Amlogic Platform Capture Driver"
	depends on !SPARC32 && !SPARC64 &&!AMLOGIC_CAMERA_ENABLE
	select VIDEOBUF_VMALLOC
	depends on MEDIA_SUPPORT
	depends on VIDEO_DEV
	depends on VIDEO_V4L2
	default n
	help
	  Amlogic capture driver interface in v4l style.
	  it can not work well together with
	  AMLOGIC_CAMERA_ENABLE
	  Say Y here if you want this driver.

config AMLOGIC_CAPTURE_FRAME_ROTATE
	bool "Enable function to support frame rotation"
	depends on AMLOGIC_VIDEO_CAPTURE
	default n
	help
	  It will support frame rotation when enable this config
	  It will support frame rotation when enable this config
	  It will support frame rotation when enable this config
	  It will support frame rotation when enable this config

config AMLOGIC_VM_DISABLE_VIDEOLAYER
	bool "Force disable Videolayer when use vm"
	depends on AMLOGIC_VIDEO_CAPTURE
	default n
	help
    It will disable amvideo provider when enable this config
    It will disable amvideo provider when enable this config
    It will disable amvideo provider when enable this config
    It will disable amvideo provider when enable this config

config AMLOGIC_VIDEO_CAPTURE_PROBE
	bool "Force check whether camera devices exist"
	depends on AMLOGIC_VIDEO_CAPTURE
	default n
	help
	  Probe whether the camera devices exist by trying to read its
	  i2c port. It may cost some time, say Y here if you want it.
	  Probe whether the camera devices exist by trying to read its
	  i2c port. It may cost some time, say Y here if you want it.

config AMLCAP_LOG_TIME_USEFORFRAMES
	bool "Print Out The Time(ms) For Process A Frame"
	depends on AMLOGIC_VIDEO_CAPTURE
	default n
	help
	  Print out the time used for process a frame, only for developers.
	  Print out the time used for process a frame, only for developers.
	  Print out the time used for process a frame, only for developers.
	  Print out the time used for process a frame, only for developers.

config AMLOGIC_VIDEO_CAPTURE_GC2145_MIPI
	tristate "Amlogic Platform Capture Driver for GC2145_MIPI"
	depends on AMLOGIC_VIDEO_CAPTURE
	default n
	help
	  Amlogic capture driver.
	  Say Y here if you want this driver.
	  Amlogic capture driver.
	  Say Y here if you want this driver.

config AMLOGIC_VIDEO_CAPTURE_OV5640
	tristate "Amlogic Platform Capture Driver for OV5640"
	select VIDEOBUF_VMALLOC
	depends on AMLOGIC_MEDIA_TVIN
	depends on AMLOGIC_MEDIA_TVIN_BT656
	depends on AMLOGIC_MEDIA_VDIN
	default n
	help
	  Amlogic capture driver.
	  Say Y here if you want this driver.
	  Amlogic capture driver.
	  Say Y here if you want this driver.

choice
	prompt "OV5642 AUTO FOCUS FIRMWARE"
	depends on AMLOGIC_VIDEO_CAPTURE_OV5642
	default NO_AUTO_FOCUS

config NO_AUTO_FOCUS
	bool "NONE"
	help
	  no auto focus
	  no auto focus
	  no auto focus
	  no auto focus

config AD5820
	bool "AD5820"
	help
	  AD5820
	  AD5820
	  AD5820
	  AD5820

config DW9714
	bool "DW9714"
	help
	  DW9714
	  DW9714
	  DW9714
	  DW9714

config AP5120
	bool "AP5120"
	help
	  AP5120
	  AP5120
	  AP5120
	  AP5120

endchoice

config AMLOGIC_MEDIA_CAMERA_UTILS
	tristate "Amlogic camera utils"
	default n
	help
		Select to enable camera utils.

endmenu
```

## drivers/media/common/Kconfig
```kconfig
# SPDX-License-Identifier: (GPL-2.0+ OR MIT)
#Ascending by module name's ASCII

source "$(COMMON_DRIVERS_DIR)/drivers/media/common/canvas/Kconfig"
source "$(COMMON_DRIVERS_DIR)/drivers/media/common/ge2d/Kconfig"
source "$(COMMON_DRIVERS_DIR)/drivers/media/common/ion_dev/Kconfig"
source "$(COMMON_DRIVERS_DIR)/drivers/media/common/vpu/Kconfig"
source "$(COMMON_DRIVERS_DIR)/drivers/media/common/rdma/Kconfig"
source "$(COMMON_DRIVERS_DIR)/drivers/media/common/vfm/Kconfig"
source "$(COMMON_DRIVERS_DIR)/drivers/media/common/codec_mm/Kconfig"
source "$(COMMON_DRIVERS_DIR)/drivers/media/common/v4l_util/Kconfig"
source "$(COMMON_DRIVERS_DIR)/drivers/media/common/uvm/Kconfig"
source "$(COMMON_DRIVERS_DIR)/drivers/media/common/lut_dma/Kconfig"
source "$(COMMON_DRIVERS_DIR)/drivers/media/common/vpu_security/Kconfig"
source "$(COMMON_DRIVERS_DIR)/drivers/media/common/resource_mgr/Kconfig"
source "$(COMMON_DRIVERS_DIR)/drivers/media/common/dma-buf-heaps/Kconfig"
source "$(COMMON_DRIVERS_DIR)/drivers/media/common/sw_sync/Kconfig"
source "$(COMMON_DRIVERS_DIR)/drivers/media/common/vicp/Kconfig"
```

## drivers/media/common/codec_mm/Kconfig
```kconfig
# SPDX-License-Identifier: (GPL-2.0+ OR MIT)
#
# Codec mermory manager driver configuration
#

config AMLOGIC_MEDIA_CODEC_MM
	tristate "Amlogic codec memory management driver"
	default n
	help
		Select to enable codec related memory management driver.
```

## drivers/media/common/dma-buf-heaps/Kconfig
```kconfig
# SPDX-License-Identifier: (GPL-2.0+ OR MIT)

menu "Amlogic dma-buf support"

config AMLOGIC_SECURE_DMABUF
	tristate "Amlogic secure dma buf memory management support"
	depends on DMABUF_HEAPS
	default n
	help
		Select to enable "Amlogic secure dma buf device support.

config AMLOGIC_HEAP_CMA
	tristate "Amlogic cma dmaheap support"
	depends on DMABUF_HEAPS
	default n
	help
		Select to enable "Amlogic cma dmaheap support.

config AMLOGIC_HEAP_CODEC_MM
	tristate "Amlogic codec_mm dmaheap support"
	depends on DMABUF_HEAPS
	default n
	help
		Select to enable "Amlogic codec_mm dmaheap support.
endmenu
```

## drivers/media/common/ion_dev/Kconfig
```kconfig
# SPDX-License-Identifier: (GPL-2.0+ OR MIT)
menu "ION support"

config AMLOGIC_ION_DEV
        tristate "ION memory management support"
        depends on AMLOGIC_ION
        default n
        help
                Select to enable "Amlogic ion device support.

source "$(COMMON_DRIVERS_DIR)/drivers/media/common/ion_dev/ion/Kconfig"

endmenu
```

## drivers/media/common/ion_dev/ion/Kconfig
```kconfig
# SPDX-License-Identifier: GPL-2.0
config AMLOGIC_ION
	bool "Ion Memory Manager"
	help
	  Choose this option to enable the ION Memory Manager,
	  used by Android to efficiently allocate buffers
	  from userspace that can be shared between drivers.
	  If you're not using Android its probably safe to
	  say N here.

config AMLOGIC_ION_SYSTEM_HEAP
	bool "Ion system heap"
	depends on AMLOGIC_ION
	help
	  Choose this option to enable the Ion system heap. The system heap
	  is backed by pages from the buddy allocator. If in doubt, say Y.
```

## drivers/media/common/sw_sync/Kconfig
```kconfig
# SPDX-License-Identifier: (GPL-2.0+ OR MIT)
#
# SW_SYNC driver configuration
#

menu "SW_SYNC driver"

config AMLOGIC_MEDIA_SW_SYNC
	bool "Amlogic SW_SYNC  driver"
	default y
	help
		remove SW_SYNC driver from media/osd
endmenu
```

## drivers/media/common/uvm/Kconfig
```kconfig
# SPDX-License-Identifier: (GPL-2.0+ OR MIT)
#
# uvm core configuration
#

menuconfig AMLOGIC_UVM_CORE
	bool "Amlogic unified video memory management"
	default n
	help
	  say y to enable Amlogic unified video memory management.
	  The uvm core is dmabuf wrap vframe framework.

menuconfig AMLOGIC_UVM_ALLOCATOR
	bool "Amlogic uvm allocator device driver"
	default n
	depends on AMLOGIC_UVM_CORE
	help
	  say y to enable amlogic uvm allocator device driver.
	  gralloc will call it to allocate dmabuf fd.
```
