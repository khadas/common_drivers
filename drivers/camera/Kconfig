## drivers/camera/Kconfig
```kconfig
# SPDX-License-Identifier: (GPL-2.0+ OR MIT)

config AMLOGIC_MEDIA_CAMERA
	tristate "Amlogic Camera driver"
	select VIDEOBUF2_DMA_CONTIG
	select V4L2_FWNODE
	select V4L2_ASYNC
	default n
	help
		This option is used to configure amlogic camera driver,
		which need use dma contig and v4l2 fwnode.
		select y for built-in
		select m for ko
		select n for disable
```

## drivers/char/Kconfig
```kconfig
# SPDX-License-Identifier: (GPL-2.0+ OR MIT)

menu "Character devices"

source "$(COMMON_DRIVERS_DIR)/drivers/char/hw_random/Kconfig"

endmenu
```

## drivers/char/hw_random/Kconfig
```kconfig
# SPDX-License-Identifier: (GPL-2.0+ OR MIT)

config AMLOGIC_HW_RANDOM_MESON
	tristate "Amlogic Meson Random Number Generator support"
	depends on HW_RANDOM
	default n
	help
	  This driver provides kernel-side support for the Random Number
	  Generator hardware found on Amlogic Meson SoCs.

	  To compile this driver as a module, choose M here. the
	  module will be called meson-rng.

	  If unsure, say Y.
```

## drivers/clk/Kconfig
```kconfig
# SPDX-License-Identifier: (GPL-2.0+ OR MIT)

source "$(COMMON_DRIVERS_DIR)/drivers/clk/meson/Kconfig"
```

## drivers/clk/meson/Kconfig
```kconfig
# SPDX-License-Identifier: GPL-2.0-only

menu "Clock support for Amlogic platforms"

config AMLOGIC_COMMON_CLK
	tristate "Meson clock common API"
	default y
	help
	  provide meson clock common
	  API and debuger tool

config AMLOGIC_COMMON_CLK_MESON_REGMAP
	tristate "meson regmap"
	depends on REGMAP

config AMLOGIC_COMMON_CLK_MESON_DUALDIV
	tristate "meson dualdiv"
	depends on AMLOGIC_COMMON_CLK_MESON_REGMAP

config AMLOGIC_COMMON_CLK_MESON_MPLL
	tristate "meson mpll"
	depends on AMLOGIC_COMMON_CLK_MESON_REGMAP

config AMLOGIC_COMMON_CLK_MESON_PHASE
	tristate "meson phase"
	depends on AMLOGIC_COMMON_CLK_MESON_REGMAP

config AMLOGIC_COMMON_CLK_MESON_PLL
	tristate "meson pll"
	depends on AMLOGIC_COMMON_CLK_MESON_REGMAP

config AMLOGIC_COMMON_CLK_MESON_SCLK_DIV
	tristate "meson sclk div"
	depends on AMLOGIC_COMMON_CLK_MESON_REGMAP

config AMLOGIC_COMMON_CLK_MESON_VID_PLL_DIV
	tristate "meson vid pll div"
	depends on AMLOGIC_COMMON_CLK_MESON_REGMAP

config AMLOGIC_COMMON_CLK_MESON_AO_CLKC
	tristate "meson ao clkc"
	depends on AMLOGIC_COMMON_CLK_MESON_REGMAP
	depends on RESET_CONTROLLER

config AMLOGIC_COMMON_CLK_MESON_EE_CLKC
	tristate "meson ee clkc"
	depends on AMLOGIC_COMMON_CLK_MESON_REGMAP

config AMLOGIC_COMMON_CLK_MESON_CPU_DYNDIV
	tristate "meson cpu dyndiv"
	depends on AMLOGIC_COMMON_CLK_MESON_REGMAP

config AMLOGIC_MESON_CLK_MEASURE
	tristate "Amlogic Meson SoC Clock Measure driver"
	depends on REGMAP_MMIO
	default n
	help
	  Say yes to support of Measuring a set of internal SoC clocks
	  from the debugfs interface.

config AMLOGIC_CLK_DEBUG
	tristate "Amlogic Meson SoC Clock Debug Driver"
	depends on AMLOGIC_BREAK_GKI
	help
	  Say yes to support of debugging online a set of SoC clocks
	  from the debugfs interface.

config AMLOGIC_COMMON_CLK_S4
	tristate "Meson S4 clock controller"
	depends on AMLOGIC_COMMON_CLK_MESON_REGMAP
	depends on AMLOGIC_COMMON_CLK_MESON_DUALDIV
	depends on AMLOGIC_COMMON_CLK_MESON_MPLL
	depends on AMLOGIC_COMMON_CLK_MESON_PLL
	depends on AMLOGIC_COMMON_CLK_MESON_CPU_DYNDIV
	depends on AMLOGIC_COMMON_CLK_MESON_VID_PLL_DIV
	depends on MFD_SYSCON
	help
	  Support for the clock controller on Amlogic AH219 and AH212
	  devices, aka s4. Say Y if you want peripherals to work.

config AMLOGIC_COMMON_CLK_SC2
	tristate "Meson SC2 clock controller"
	depends on AMLOGIC_COMMON_CLK_MESON_REGMAP
	depends on AMLOGIC_COMMON_CLK_MESON_DUALDIV
	depends on AMLOGIC_COMMON_CLK_MESON_MPLL
	depends on AMLOGIC_COMMON_CLK_MESON_PLL
	depends on AMLOGIC_COMMON_CLK_MESON_CPU_DYNDIV
	depends on AMLOGIC_COMMON_CLK_MESON_VID_PLL_DIV
	depends on MFD_SYSCON
	help
	  Support for the clock controller on Amlogic AH219 and AH212
	  devices, aka sc2. Say Y if you want peripherals to work.

config AMLOGIC_COMMON_CLK_C2
	tristate "Meson C2 clock controller"
	depends on AMLOGIC_COMMON_CLK_MESON_REGMAP
	depends on AMLOGIC_COMMON_CLK_MESON_DUALDIV
	depends on AMLOGIC_COMMON_CLK_MESON_MPLL
	depends on AMLOGIC_COMMON_CLK_MESON_PLL
	depends on AMLOGIC_COMMON_CLK_MESON_CPU_DYNDIV
	depends on MFD_SYSCON
	default n
	help
	 Support for the clock controller on Amlogic AF400
	 devices. Say Y if you want peripherals to work.

config AMLOGIC_COMMON_CLK_C3
	tristate "Meson C3 clock controller"
	depends on AMLOGIC_COMMON_CLK_MESON_REGMAP
	depends on AMLOGIC_COMMON_CLK_MESON_DUALDIV
	depends on AMLOGIC_COMMON_CLK_MESON_MPLL
	depends on AMLOGIC_COMMON_CLK_MESON_PLL
	depends on AMLOGIC_COMMON_CLK_MESON_CPU_DYNDIV
	depends on MFD_SYSCON
	default n
	help
	 Support for the clock controller on Amlogic C3
	 chipset. Say Y if you want peripherals to work.

config AMLOGIC_COMMON_CLK_A1
	tristate "Meson A1 clock controller"
	depends on AMLOGIC_COMMON_CLK_MESON_REGMAP
	depends on AMLOGIC_COMMON_CLK_MESON_DUALDIV
	depends on AMLOGIC_COMMON_CLK_MESON_MPLL
	depends on AMLOGIC_COMMON_CLK_MESON_PLL
	depends on AMLOGIC_COMMON_CLK_MESON_CPU_DYNDIV
	depends on MFD_SYSCON
	default n
	help
	 Support for the clock controller on Amlogic A1
	 chipset. Say Y if you want peripherals to work.

config AMLOGIC_COMMON_CLK_T3
	tristate "Meson T3 clock controller"
	depends on AMLOGIC_COMMON_CLK_MESON_REGMAP
	depends on AMLOGIC_COMMON_CLK_MESON_DUALDIV
	depends on AMLOGIC_COMMON_CLK_MESON_MPLL
	depends on AMLOGIC_COMMON_CLK_MESON_PLL
	depends on AMLOGIC_COMMON_CLK_MESON_CPU_DYNDIV
	depends on AMLOGIC_COMMON_CLK_MESON_VID_PLL_DIV
	depends on MFD_SYSCON
	help
	  Support for the clock controller on Amlogic T3
	  devices, aka t3. Say Y if you want peripherals to work.

config AMLOGIC_COMMON_CLK_T7
	tristate "Meson T7 clock controller"
	depends on AMLOGIC_COMMON_CLK_MESON_REGMAP
	depends on AMLOGIC_COMMON_CLK_MESON_DUALDIV
	depends on AMLOGIC_COMMON_CLK_MESON_MPLL
	depends on AMLOGIC_COMMON_CLK_MESON_PLL
	depends on AMLOGIC_COMMON_CLK_MESON_CPU_DYNDIV
	depends on AMLOGIC_COMMON_CLK_MESON_VID_PLL_DIV
	depends on MFD_SYSCON
	help
	  Support for the clock controller on Amlogic T7
	  devices, aka t7. Say Y if you want peripherals to work.

config AMLOGIC_COMMON_CLK_T5M
	tristate "Meson T5M clock controller"
	depends on AMLOGIC_COMMON_CLK_MESON_REGMAP
	depends on AMLOGIC_COMMON_CLK_MESON_DUALDIV
	depends on AMLOGIC_COMMON_CLK_MESON_PLL
	depends on AMLOGIC_COMMON_CLK_MESON_CPU_DYNDIV
	depends on AMLOGIC_COMMON_CLK_MESON_VID_PLL_DIV
	depends on MFD_SYSCON
	help
	  Support for the clock controller on Amlogic T5M
	  devices, aka t5m. Say Y if you want peripherals to work.
endmenu
```

## drivers/cpu_info/Kconfig
```kconfig
# SPDX-License-Identifier: (GPL-2.0+ OR MIT)

config AMLOGIC_CPU_INFO
	tristate "Amlogic chipid"
	depends on AMLOGIC_SECMON
	depends on MFD_SYSCON
	default n
	help
	  say y to enable Amlogic chipid driver
          include to driver
	  cpu info, access with smccc
	  cpu version, access with reg

config AMLOGIC_SHOW_CPU_CHIPID
	bool "Amlogic show cpu chipid in /proc/cpu_chipid"
	depends on AMLOGIC_CPU_INFO
	default n
	help
	  show cpu chipid in /proc/cpuinfo
```

## drivers/cpuidle/Kconfig
```kconfig
# SPDX-License-Identifier: (GPL-2.0+ OR MIT)

config AMLOGIC_CPUIDLE
	tristate  "Amlogic cpuidle support"
	depends on AMLOGIC_BREAK_GKI
	default n
	help
	 select y if want to support Amlogic cpuidle.
```

## drivers/ddr_scrambler/Kconfig
```kconfig
config AMLOGIC_DDR_SCRAMBLER
	tristate "Amlogic ddr scrambler keypreserve mode for pstore debug"
	depends on PSTORE
	default n
	help
		Preserve ddr scrambler key to dump kernel console message and panic/oops
		message.
```

## drivers/debug/Kconfig
```kconfig
config AMLOGIC_DEBUG
	tristate "AMLOGIC kernel debug"
	default n
	help
	  This option is set up for Amlogic kernel debug,
	  Modifying the source code, we will use the AMLOGIC_
	  prefix.If you want to add debug code to the kernel,please
	  use this option switch it.

config AMLOGIC_BGKI_DEBUG_MISC
	bool "Amlogic Debug Builtin Code"
	depends on AMLOGIC_DEBUG
	depends on AMLOGIC_BREAK_GKI_20
	default n
	help
	  Amlogic debug code must builtin
	  Enable if doubt

config AMLOGIC_DEBUG_ATRACE
	bool "Amlogic Kernel ATrace"
	depends on AMLOGIC_DEBUG
	depends on TRACING
	default n
	help
	  Add android atrace compatible function.
	  Support Tags

config AMLOGIC_BOOT_TIME
	bool "AMLOGIC boot time optimization"
	depends on AMLOGIC_BREAK_GKI
	default n
	help
	  This option is set up for Amlogic boot time optimization,
	  if you want to optimize boot time, please set this config to y.

config AMLOGIC_DEBUG_PRINTK
	tristate "Amlogic printk support"
	depends on PRINTK_CALLER
	default n
	help
	  if you want to print information such as cpu irq,
	  please use this option switch it.

config AMLOGIC_DEBUG_FILE
	bool "Amlogic dump log to debug file"
	default n
	help
	  Provide some interfaces for dumping log to debug file

config AMLOGIC_DEBUG_TEST
	tristate "Amlogic debug test on init"
	depends on AMLOGIC_DEBUG
	default n
	help
	  auto test on debug init

config AMLOGIC_DEBUG_HLD
	bool "Amlogic hardlockup detector support"
	depends on AMLOGIC_DEBUG
	default n
	help
	  if you want to hardlockup detector support,
	  please use this option switch it.


config AMLOGIC_DEBUG_MHZ
	bool "Amlogic hardlockup detector support"
	depends on AMLOGIC_DEBUG
	default y if (AMLOGIC_DEBUG=y || AMLOGIC_DEBUG=m)
	help
	  if you want to hardlockup detector support,

config AMLOGIC_HOTPLUG_ARM_CPU0
	bool "Support VTS thermal 1.0 test on arm"
	default n
	help
	  if build with arm set this config to y for vts thermal 1.0 test,
	  set config to n for arm64

config AMLOGIC_AUDIO_UTILS
	tristate "Amlogic audio utils"
	default n
	help
	  add some debug tools

config AMLOGIC_GKI_CONFIG
	bool "Meson gki config"
	depends on AMLOGIC_DEBUG
	default n
	help
	  support GKI config enable or not

config AMLOGIC_ENV_DEBUG
	bool "AMLOGIC env debug"
	depends on AMLOGIC_BREAK_GKI_20
	depends on AMLOGIC_DEBUG
	default n
	help
	  support amlogic env debug function

config AMLOGIC_ZAPPER_NET_CUT
	bool "zapper cut network"
	depends on AMLOGIC_DEBUG
	depends on AMLOGIC_BREAK_GKI
	default n
	help
	  remove more for zapper network

config AMLOGIC_ZAPPER_CUT
	bool "zapper cut"
	depends on AMLOGIC_DEBUG
	depends on AMLOGIC_BREAK_GKI
	default n
	help
	  remove more for zapper

config AMLOGIC_ZAPPER_CUT_C1A
	bool "zapper C1A"
	depends on AMLOGIC_DEBUG
	default n
	help
	  remove more for zapper c1a

config AMLOGIC_REMOVE_OLD
	bool "zapper cut"
	depends on AMLOGIC_DEBUG
	default n
	help
	  remove more for zapper

config AMLOGIC_C3_REMOVE
	bool "c3 project cut"
	default n
	help
	  remove more for c3 project

config AMLOGIC_DEBUG_IOTRACE
	tristate "amlogic debug iotrace config"
	default n
	help
	  support io/sched/irq/smc/misc trace

config AMLOGIC_ARMV8_AARCH32
	bool "AARCH32 kernel support for Amlogic ARMv8 Soc"
	depends on AMLOGIC_BREAK_GKI_20
	default n
	help
	  32 bit kernel support for amlogic armv8 SoC.
	  choose y if you wanna kerenl working in ARMv8 AARCH32 mode

config AMLOGIC_APU
	bool "Amlogic APU enable"
	default n
	depends on AMLOGIC_BREAK_GKI_20
	help
	  this option is provide for AMLOGIC APU support, eg t3x/t5m
	  has dedicated core for APU and should not used by other
	  modules, and should enable

config AMLOGIC_BGKI_SCHED_SYSCTL
	bool "Amlogic sched sysctl"
	default n
	depends on AMLOGIC_BREAK_GKI
	help
	  this is for vts vts_kernel_proc_file_api_test support in
	  android S.

config AMLOGIC_ARM_UNWIND
	bool "Amlogic modify in arm unwind"
	depends on ARM_UNWIND
	default n
	help
	 This option enable Amlogic arm unwind function
	 If in doubt, say "Y"

config AMLOGIC_DEBUG_ISOLCPUS
	bool "Amlogic isolate APU"
	default n
	depends on AMLOGIC_DEBUG
	help
	  this option is provided for AMLOGIC isolate CPU5 modifications.

config AMLOGIC_F2FS_OPTIMIZATION
	bool "AMLOGIC f2fs optimization"
	depends on AMLOGIC_BREAK_GKI_20
	default y
	help
	  This option is set up for Amlogic f2fs optimization,
	  if you want to optimize f2fs, please set this config to y.
```

## drivers/dolby_fw/Kconfig
```kconfig
# SPDX-License-Identifier: (GPL-2.0+ OR MIT)
config AMLOGIC_DOLBY_FW
	tristate "Dolby FW kernel driver"
	default n
	help
	This is Dolby FW Driver.
```

## drivers/drm/Kconfig
```kconfig
# SPDX-License-Identifier: (GPL-2.0+ OR MIT)

config AMLOGIC_DRM
	tristate "DRM Support for Amlogic new Display Controller"
	default n
	depends on AMLOGIC_DRIVER && DRM && OF && (ARM || ARM64)
	depends on DRM_KMS_HELPER
	depends on DRM_KMS_CMA_HELPER
	depends on DRM_GEM_CMA_HELPER
	depends on VIDEOMODE_HELPERS
	help
		amlogic new soc display controller
		use the pipeline and modularized

config AMLOGIC_DRM_VPU
	bool "support drm vpu function for meson drm display."
	default n
	depends on AMLOGIC_DRM
	help
		add drm vpu support.
		Choose this option if you have a aMLOGIC soc chipset.
		This driver provides KMS.
		This driver also provides crtcs and planes management.

config AMLOGIC_DRM_HDMI
	bool "support drm hdmi function for meson drm display."
	default n
	depends on AMLOGIC_DRM
	depends on AMLOGIC_HDMITX
	help
		add drm hdmi support.
		use internal amlogic media vout hdmi driver.
		We should confirm AMLOGIC_HDMITX is configured if
		AMLOGIC_DRM_HDMI is selected.

config AMLOGIC_DRM_CVBS
	bool "support drm cvbs function for meson drm display."
	default n
	depends on AMLOGIC_DRM
	depends on AMLOGIC_CVBS_OUTPUT
	help
		add drm cvbs support.
		use internal amlogic media vout cvbs driver.
		We should confirm AMLOGIC_CVBSOUT is configured if
		AMLOGIC_DRM_CVBS is selected.

config AMLOGIC_DRM_PANEL
	bool "support drm panel function for meson drm display."
	default n
	depends on AMLOGIC_DRM
	depends on AMLOGIC_LCD
	depends on DRM_PANEL
	help
		add drm panel support.
		use internal amlogic media vout lcd driver.
		We should confirm AMLOGIC_LCD is configured if
		AMLOGIC_DRM_PANEL is selected.

config AMLOGIC_DRM_USE_ION
	bool "gem use ion to alloc/free graphic buffer."
	default n
	depends on AMLOGIC_DRM
	help
		MESON DRM use CMA HELPER to manage framebuffer.
		It need reserve memory in CMA pool.
		We implement GEM to allocate/free framebuffer from ion.
		For dumb used by displaycontrol we alloc from the ION CMA HEAP.
		For dumb used by app, we can alloc from the ION.
		SYSTEM HEAP which dont need reserve memory.

config AMLOGIC_DRM_EMULATE_FBDEV
	bool "emulate framebuffer dev by drm."
	default n
	depends on AMLOGIC_DRM && AMLOGIC_DRM_USE_ION
	help
		Emulate framebuffer device for device
		which need use fbdev api.
```

## drivers/dvb/Kconfig
```kconfig
# SPDX-License-Identifier: GPL-2.0-or-later

config AMLOGIC_DVB_CONFIG
	tristate "Amlogic dvb support"
	default n
	help
		amlogic dvb support
		Y: enable
		N: disable
		M: build as module

if AMLOGIC_DVB_CONFIG

config AMLOGIC_DVB_EXTERN
	bool "Amlogic dvb extern drivers"
	help
		Say Y here if you want to support amlogic dvb extern driver.

config AMLOGIC_DVB_DSM
	bool "AMLOGIC DVB DSM"
	help
		Amlogic DVB Descrambler Session Manager

config AMLOGIC_DVB_COMPAT
	bool "AMLOGIC DVB COMPAT"
	default n
	help
		if define Amlogic define demod or dmx
		it should define AMLOGIC_DVB_COMPAT

source "$(COMMON_DRIVERS_DIR)/drivers/dvb/aucpu/Kconfig"
source "$(COMMON_DRIVERS_DIR)/drivers/dvb/smartcard_sc2/Kconfig"

endif

#
#dvb driver for demux
#
config AMLOGIC_DVB_DMX
	tristate "AMLOGIC DVB DMX"
	depends on AMLOGIC_TEE
	help
		support dmx/dsc driver.
```

## drivers/dvb/aucpu/Kconfig
```kconfig
# SPDX-License-Identifier: GPL-2.0-or-later
#
# Amlogic AUCPU driver configuration
#
config AMLOGIC_AUCPU
	bool "Amlogic Aucpu driver"
	default N
#	depends on AMLOGIC_MEDIA_CODEC_MM
	help
		Amlogic AUCPU Driver module support
		This module driver support amlogic aucpu
```

## drivers/dvb/smartcard_sc2/Kconfig
```kconfig
# SPDX-License-Identifier: (GPL-2.0+ OR MIT)
#
#Smart card driver configuration
#

config AMLOGIC_SMARTCARD
	bool "Amlogic Smartcard driver"
	default n
```
