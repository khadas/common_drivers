## drivers/Kconfig
```kconfig
# SPDX-License-Identifier: (GPL-2.0+ OR MIT)

menu "Amlogic Device Drivers"

source "$(COMMON_DRIVERS_DIR)/drivers/tty/Kconfig"
source "$(COMMON_DRIVERS_DIR)/drivers/clk/Kconfig"
source "$(COMMON_DRIVERS_DIR)/drivers/secmon/Kconfig"
source "$(COMMON_DRIVERS_DIR)/drivers/drm/Kconfig"
source "$(COMMON_DRIVERS_DIR)/drivers/media/Kconfig"
source "$(COMMON_DRIVERS_DIR)/drivers/power/Kconfig"
source "$(COMMON_DRIVERS_DIR)/drivers/cpu_info/Kconfig"
source "$(COMMON_DRIVERS_DIR)/drivers/pm/Kconfig"
source "$(COMMON_DRIVERS_DIR)/drivers/gpio/Kconfig"
source "$(COMMON_DRIVERS_DIR)/drivers/input/Kconfig"
source "$(COMMON_DRIVERS_DIR)/drivers/i2c/Kconfig"
source "$(COMMON_DRIVERS_DIR)/drivers/spi/Kconfig"
source "$(COMMON_DRIVERS_DIR)/drivers/tee/Kconfig"
source "$(COMMON_DRIVERS_DIR)/drivers/aml_tee/Kconfig"
source "$(COMMON_DRIVERS_DIR)/drivers/gki_tool/Kconfig"
source "$(COMMON_DRIVERS_DIR)/drivers/pwm/Kconfig"
source "$(COMMON_DRIVERS_DIR)/drivers/cpufreq/Kconfig"
source "$(COMMON_DRIVERS_DIR)/drivers/efuse_unifykey/Kconfig"
source "$(COMMON_DRIVERS_DIR)/drivers/mailbox/Kconfig"
source "$(COMMON_DRIVERS_DIR)/drivers/jtag/Kconfig"
source "$(COMMON_DRIVERS_DIR)/drivers/watchdog/Kconfig"
source "$(COMMON_DRIVERS_DIR)/drivers/memory_ext/Kconfig"
source "$(COMMON_DRIVERS_DIR)/drivers/memory_debug/Kconfig"
source "$(COMMON_DRIVERS_DIR)/drivers/iio/Kconfig"
source "$(COMMON_DRIVERS_DIR)/drivers/char/Kconfig"
source "$(COMMON_DRIVERS_DIR)/drivers/soc_info/Kconfig"
source "$(COMMON_DRIVERS_DIR)/drivers/reset/Kconfig"
source "$(COMMON_DRIVERS_DIR)/drivers/rtc/Kconfig"
source "$(COMMON_DRIVERS_DIR)/drivers/irblaster/Kconfig"
source "$(COMMON_DRIVERS_DIR)/drivers/thermal/Kconfig"
source "$(COMMON_DRIVERS_DIR)/drivers/mmc/Kconfig"
source "$(COMMON_DRIVERS_DIR)/drivers/host/Kconfig"
source "$(COMMON_DRIVERS_DIR)/drivers/debug/Kconfig"
source "$(COMMON_DRIVERS_DIR)/drivers/camera/Kconfig"
source "$(COMMON_DRIVERS_DIR)/drivers/freertos/Kconfig"
source "$(COMMON_DRIVERS_DIR)/drivers/usb/Kconfig"
source "$(COMMON_DRIVERS_DIR)/drivers/crypto/Kconfig"
source "$(COMMON_DRIVERS_DIR)/drivers/wireless/Kconfig"
source "$(COMMON_DRIVERS_DIR)/drivers/net/Kconfig"
source "$(COMMON_DRIVERS_DIR)/drivers/mtd/spinand/Kconfig"
source "$(COMMON_DRIVERS_DIR)/drivers/mtd/nand/Kconfig"
source "$(COMMON_DRIVERS_DIR)/drivers/mtd/common/Kconfig"
source "$(COMMON_DRIVERS_DIR)/drivers/dvb/Kconfig"
source "$(COMMON_DRIVERS_DIR)/drivers/pci/Kconfig"
source "$(COMMON_DRIVERS_DIR)/drivers/led/Kconfig"
source "$(COMMON_DRIVERS_DIR)/drivers/dvb_ci/Kconfig"
source "$(COMMON_DRIVERS_DIR)/drivers/dvb_usbci/Kconfig"
source "$(COMMON_DRIVERS_DIR)/drivers/hwspinlock/Kconfig"
source "$(COMMON_DRIVERS_DIR)/drivers/android/Kconfig"
source "$(COMMON_DRIVERS_DIR)/drivers/yaffs2/Kconfig"
source "$(COMMON_DRIVERS_DIR)/drivers/mfd/Kconfig"
source "$(COMMON_DRIVERS_DIR)/drivers/regulator/Kconfig"
source "$(COMMON_DRIVERS_DIR)/drivers/audiobridge/Kconfig"
source "$(COMMON_DRIVERS_DIR)/drivers/algorithm/Kconfig"
source "$(COMMON_DRIVERS_DIR)/drivers/firmware/Kconfig"
source "$(COMMON_DRIVERS_DIR)/drivers/timestamp/Kconfig"
source "$(COMMON_DRIVERS_DIR)/drivers/seckey/Kconfig"
source "$(COMMON_DRIVERS_DIR)/drivers/aml_trusted_keys/Kconfig"
source "$(COMMON_DRIVERS_DIR)/scripts/Kconfig"
endmenu
```

## drivers/algorithm/Kconfig
```kconfig
#
# Amlogic multimedia algorithm configuration
#

menu "Amlogic multimedia algorithm configuration"

config AMLOGIC_MEDIA_ALGORITHM
	tristate "Amlogic Multimedia Algorithm Support"
	default m
	help
		Amlogic multimedia algorithm include:
		dnlp
		hdr10
		sl_hdr
		ldim
		frc

if AMLOGIC_MEDIA_ALGORITHM
#source "$(COMMON_DRIVERS_DIR)/drivers/algorithm/ldim/Kconfig"
#source "$(COMMON_DRIVERS_DIR)/drivers/algorithm/dnlp/Kconfig"
#source "$(COMMON_DRIVERS_DIR)/drivers/algorithm/common/Kconfig"
#source "$(COMMON_DRIVERS_DIR)/drivers/algorithm/frc/Kconfig"
endif

endmenu
```

## drivers/algorithm/common/Kconfig
```kconfig
#
# Amlogic multimedia common algorithm configuration
#

menu "Amlogic multimedia algorithm configuration"

config AMLOGIC_COMMON_ALGORITHM
	bool "amlogic Multimedia Common Algorithm Support"
	default n
	help
		Amlogic multimedia common algorithm include:
		cabc
		aad
		pregm
		hdr10_tmo

if AMLOGIC_COMMON_ALGORITHM

source "$(COMMON_DRIVERS_DIR)/drivers/algorithm/common/cabc/Kconfig"
source "$(COMMON_DRIVERS_DIR)/drivers/algorithm/common/aad/Kconfig"
source "$(COMMON_DRIVERS_DIR)/drivers/algorithm/common/pregm/Kconfig"
source "$(COMMON_DRIVERS_DIR)/drivers/algorithm/common/hdr10_tmo/Kconfig"
source "$(COMMON_DRIVERS_DIR)/drivers/algorithm/common/blue_stretch/Kconfig"
source "$(COMMON_DRIVERS_DIR)/drivers/algorithm/common/cuva/Kconfig"
source "$(COMMON_DRIVERS_DIR)/drivers/algorithm/common/color_tune/Kconfig"
endif

endmenu
```

## drivers/algorithm/common/aad/Kconfig
```kconfig
#
# cabc aad algorithm configuration
#

config AMLOGIC_AAD_ALGORITHM
	bool "Amlogic AAD Algorithm"
	default n
	depends on AMLOGIC_MEDIA_ENHANCEMENT_VECM
	help
		AAD algorithm
		Configure algorithm for AAD function
```

## drivers/algorithm/common/blue_stretch/Kconfig
```kconfig
#
# blue stretch algorithm configuration
#

config AMLOGIC_BLS_ALGORITHM
	bool "Amlogic BLS Algorithm"
	default n
	depends on AMLOGIC_MEDIA_ENHANCEMENT_VECM
	help
		PREGM algorithm
		Configure algorithm for blue stretch function
```

## drivers/algorithm/common/cabc/Kconfig
```kconfig
#
# cabc aad algorithm configuration
#

config AMLOGIC_CABC_ALGORITHM
	bool "Amlogic CABC Algorithm"
	default n
	depends on AMLOGIC_MEDIA_ENHANCEMENT_VECM
	help
		CABC algorithm
		Configure algorithm for CABC function
```

## drivers/algorithm/common/color_tune/Kconfig
```kconfig
#
# blue stretch algorithm configuration
#

config AMLOGIC_COLOR_TUNE_ALGORITHM
	bool "Amlogic Color Tune Algorithm"
	default n
	depends on AMLOGIC_MEDIA_ENHANCEMENT_VECM
	help
		PREGM algorithm
		Configure algorithm for blue stretch function
```

## drivers/algorithm/dnlp/Kconfig
```kconfig
#
# DNLP Algorithm Driver Configuration
#

config AMLOGIC_DNLP_ALGORITHM
	bool "Amlogic DNLP Algorithm"
	default n
	depends on AMLOGIC_MEDIA_ENHANCEMENT_VECM
	help
	  Say Y here if
	  you want to use
	  the amlogic hold
	  dnlp.
```

## drivers/aml_trusted_keys/Kconfig
```kconfig
config AMLOGIC_LINUX_FBE
	bool "Amlogic's FBE implementation"
	default n
	depends on AMLOGIC_TRUSTED_KEYS && AMLOGIC_TRUSTED_KEYS_TEE
	help
	  This option is for enabling Amlogic's FBE feature. Currently,
	  it only works on trusted-key with tee backend.

config AMLOGIC_LINUX_FBE_RDK
	bool "Customization of Amlogic's FBE for RDK"
	depends on AMLOGIC_LINUX_FBE
	default n
	help
	  This option is for enabling customization of Amlogic's FBE for RDK

config AMLOGIC_TRUSTED_KEYS
	tristate "AMLOGIC TRUSTED_KEYS"
	depends on KEYS
	default n
	help
	  This option provides support for creating, sealing, and unsealing
	  keys in the kernel. Trusted keys are random number symmetric keys,
	  generated and sealed by a trust source selected at kernel boot-time.
	  Userspace will only ever see encrypted blobs.

	  If you are unsure as to whether this is required, answer N.

config AMLOGIC_TRUSTED_KEYS_TEE
	tristate "Amlogic TEE-based trusted keys"
	depends on AML_TEE >= AMLOGIC_TRUSTED_KEYS
	default n
	help
	  Enable use of the Trusted Execution Environment (TEE) as trusted
	  key backend.
```

## drivers/android/Kconfig
```kconfig
# SPDX-License-Identifier: GPL-2.0

config AMLOGIC_ANDROID_LOGGER
	tristate "Android log driver"
	default n
	help
		This adds support for system-wide logging using four log buffers.
		These are:
			1: main
			2: events
			3: radio
			4: system

		Log reading and writing is performed via normal Linux reads and
		optimized writes. This optimization avoids logging having too
		much overhead in the system.

config ANDROID_LOW_MEMORY_KILLER
	bool "Android Low Memory Killer"
	help
		Registers processes to be killed when low memory conditions, this is useful
		as there is no particular swap space on android.

		The registered process will kill according to the priorities in android init
		scripts (/init.rc), and it defines priority values with minimum free memory size
		for each priority.

config ANDROID_LOW_MEMORY_KILLER_AUTODETECT_OOM_ADJ_VALUES
	bool "Android Low Memory Killer: detect oom_adj values"
	depends on ANDROID_LOW_MEMORY_KILLER
	default y
	help
		Detect oom_adj values written to
		/sys/module/lowmemorykiller/parameters/adj and convert them
		to oom_score_adj values.

config AMLOGIC_LMK
	bool "Amlogic Low Memory Killer vendor"
	depends on AMLOGIC_BREAK_GKI
	help
		Add file free page statistics, which also triggers lmkd
		when there are many files in free.
```

## drivers/armisp-g12b/Kconfig
```kconfig
menu "Amlogic ISP Support for G12B"

config AMLOGIC_ARM_ISP_G12B
	tristate "amlogic ISP module for G12B"
	default m
	help
	  Driver for ISP.

endmenu
```

## drivers/armisp/Kconfig
```kconfig
menu "Amlogic ISP Support"

config AMLOGIC_ARM_ISP
	tristate "amlogic ISP module"
	default m
	help
	  Driver for ISP.

endmenu
```
