## drivers/dvb_ci/Kconfig
```kconfig
#
#dvb driver for dvb ci
#
menu "AMLOGIC DVB CI support"

config AMLOGIC_DVB_CI
   tristate "AMLOGIC DVB CI"
   default n
   help
     support dvb ci driver.

endmenu
```

## drivers/firmware/Kconfig
```kconfig
# SPDX-License-Identifier: (GPL-2.0+ OR MIT)
#
# Amlogic freertos configuration
#
menu "AMLOGIC firmware boot"

config AMLOGIC_FIRMWARE
	tristate "firmware bootup support"
	default n
	help
		support the amlogic firmware bootup;

endmenu
```

## drivers/freertos/Kconfig
```kconfig
# SPDX-License-Identifier: (GPL-2.0+ OR MIT)
#
# Amlogic freertos configuration
#

config AMLOGIC_FREERTOS
	bool "Amlogic Freertos Support"
	depends on AMLOGIC_BREAK_GKI
	default n
	help
	  Say Y here to enable freertos support.

config AMLOGIC_FREERTOS_NOFITIER
	bool "Amlogic Freertos Support nofitier"
	depends on AMLOGIC_FREERTOS
	default n
	help
	  Say Y here to enable freertos nofitier support.

config AMLOGIC_FREERTOS_IS_MAP
	bool "Amlogic Freertos memory are map to kernel"
	depends on AMLOGIC_FREERTOS
	default n
	help
	  Say Y here memory are map to kernel.

config AMLOGIC_FREERTOS_MEMORY_FREE
	  bool "Amlogic Freertos memory need free"
	  depends on AMLOGIC_FREERTOS
	  default n
	  help
	    Say Y here memory need to free.

config AMLOGIC_FREERTOS_IPI_SEND
	    bool "Amlogic Freertos ipi send"
	    depends on AMLOGIC_FREERTOS
	    default n
	    help
	      Say Y here to enable ipi send support.

config AMLOGIC_FREERTOS_ANDROID_CTRL
	    bool "Amlogic Freertos android ctrl"
	    depends on AMLOGIC_FREERTOS
	    default n
	    help
	      Say Y here to enable android ctrl support.

config AMLOGIC_FREERTOS_T7
	bool "Amlogic Freertos Support with t7"
	depends on AMLOGIC_BREAK_GKI
	depends on AMLOGIC_FREERTOS
	select AMLOGIC_FREERTOS_NOFITIER
	select AMLOGIC_FREERTOS_IS_MAP
	select AMLOGIC_FREERTOS_MEMORY_FREE
	select AMLOGIC_FREERTOS_IPI_SEND
	select AMLOGIC_FREERTOS_ANDROID_CTRL
	default n
	help
	  Say Y here to enable freertos support.

config AMLOGIC_FREERTOS_C3
	bool "Amlogic Freertos Support with c3"
	depends on AMLOGIC_FREERTOS
	select AMLOGIC_FREERTOS_NOFITIER
	select AMLOGIC_FREERTOS_IS_MAP
	select AMLOGIC_FREERTOS_MEMORY_FREE
	select AMLOGIC_FREERTOS_IPI_SEND
	default n
	help
	  Say Y here to enable freertos support.

config AMLOGIC_AUTO_CAPTURE
	bool "Amlogic camera auto capture"
	default n
	help
	  This option is used to configure Amlogic camera auto capture.
	  User space would use a block of reserved memory to save captured camera,
	  then free this reserved memory after using it.
```

## drivers/gki_tool/Kconfig
```kconfig
# SPDX-License-Identifier: (GPL-2.0+ OR MIT)

config AMLOGIC_GKI_TOOL
	tristate "Meson gki tool"
	default n
	help
	  provide common tools for GKI ko,
	  including __setup...
```

## drivers/gpio/Kconfig
```kconfig
# SPDX-License-Identifier: (GPL-2.0+ OR MIT)

config AMLOGIC_GPIO
	tristate "Amlogic gpio support"
	default n
	help
	  gpio device support
	  select y for built-in
	  select m for ko
	  select n for disable

if AMLOGIC_GPIO

config AMLOGIC_GPIOLIB
	bool "Amlogic gpiolib expand"
	depends on AMLOGIC_GPIO
	depends on GPIOLIB
	default n
	help
	  Say Y here if you want to use the
	  amlogic gpiolib expand.

source "$(COMMON_DRIVERS_DIR)/drivers/gpio/irqchip/Kconfig"
source "$(COMMON_DRIVERS_DIR)/drivers/gpio/pinctrl/Kconfig"

endif # AMLOGIC_GPIO
```

## drivers/gpio/irqchip/Kconfig
```kconfig
# SPDX-License-Identifier: GPL-2.0

config AMLOGIC_MESON_IRQ_GPIO
	bool "Amlogic GPIO Interrupt Multiplexer"
	depends on IRQ_DOMAIN_HIERARCHY
	help
	  Support Meson SoC Family GPIO Interrupt Multiplexer
```

## drivers/gpio/meson_pmic6b/Kconfig
```kconfig
# SPDX-License-Identifier: (GPL-2.0+ OR MIT)
#
# AMLOGIC_GPIO_PMIC drivers configuration
#

menuconfig AMLOGIC_GPIO_PMIC
	bool "Amlogic GPIO Support"
	default n
	help
	  This enables GPIO support through the generic GPIO library.
	  You only need to enable this, if you also want to enable
	  one or more of the GPIO drivers below.

	  If unsure, say no.

if AMLOGIC_GPIO_PMIC

config AMLOGIC_GPIO_PMIC6B
	bool "Amlogic RTC PMIC6B"
	depends on REGMAP_I2C
	depends on AMLOGIC_MFD
	depends on AMLOGIC_MFD_PMIC6B
	default n
	help
	  Say yes here to add support for the Amlogic GPIO PMIC6B.

endif
```

## drivers/gpio/pinctrl/Kconfig
```kconfig
# SPDX-License-Identifier: GPL-2.0-only

menuconfig AMLOGIC_PINCTRL_MESON
	bool "Amlogic SoC pinctrl drivers"
	depends on OF
	depends on PINMUX
	depends on PINCONF
	depends on GENERIC_PINCONF
	depends on GPIOLIB
	depends on OF_GPIO
	depends on REGMAP_MMIO

if AMLOGIC_PINCTRL_MESON
config AMLOGIC_PINCTRL_MESON_S4
	tristate "Meson s4 Soc pinctrl driver"
	default n
	help
	  the chip of s4 will be built
	  when enable this config.
	  s4 pinctrl can work.
	  otherwise s4 pinctrl can't work

config AMLOGIC_PINCTRL_MESON_C2
	tristate "Meson c2 Soc pinctrl driver"
	default n
	help
	  the chip of c2 will be built
	  when enable this config.
	  c2 pinctrl can work.
	  otherwise c2 pinctrl can't work

config AMLOGIC_PINCTRL_MESON_C3
	tristate "Meson C3 Soc pinctrl driver"
	default n
	help
	  the chip of C3 will be built
	  when enable this config.
	  C3 pinctrl can work.
	  otherwise C3 pinctrl can't work

config AMLOGIC_PINCTRL_MESON_A1
	tristate "Meson A1 Soc pinctrl driver"
	default n
	help
	  the chip of A1 will be built
	  when enable this config.
	  A1 pinctrl can work.
	  otherwise A1 pinctrl can't work

config AMLOGIC_PINCTRL_MESON_SC2
	tristate "Meson SC2 Soc pinctrl driver"
	default n
	help
	  the chip of SC2 will be built
	  when enable this config.
	  SC2 pinctrl can work.
	  otherwise SC2 pinctrl can't work

config AMLOGIC_PINCTRL_MESON_T3
	tristate "Meson T3 Soc pinctrl driver"
	default n
	help
	  the chip of T3 will be built
	  when enable this config.
	  T3 pinctrl can work.
	  otherwise T3 pinctrl can't work

config AMLOGIC_PINCTRL_MESON_T7
	tristate "Meson T7 Soc pinctrl driver"
	default n
	help
	  the chip of T7 will be built
	  when enable this config.
	  T7 pinctrl can work.
	  otherwise T7 pinctrl can't work

config AMLOGIC_PINCTRL_MESON_T5M
	tristate "Meson T5M Soc pinctrl driver"
	default n
	help
	  the chip of T5M will be built
	  when enable this config.
	  T5M pinctrl can work.
	  otherwise T5M pinctrl can't work

config AMLOGIC_PINCTRL_MESON_G12A
	tristate "Meson G12A Soc pinctrl driver"
	default n
	help
	  the chip of G12A will be built
	  when enable this config.
	  G12A pinctrl can work.
	  otherwise G12A pinctrl can't work

config AMLOGIC_PINCTRL_MESON_S5
	tristate "Meson S5 Soc pinctrl driver"
	default n
	help
	  the chip of S5 will be built
	  when enable this config.
	  S5 pinctrl can work.
	  otherwise S5 pinctrl can't work

config AMLOGIC_PINCTRL_MESON_T5W
	tristate "Meson T5W Soc pinctrl driver"
	default n
	help
	  the chip of T5W will be built
	  when enable this config.
	  T5M pinctrl can work.
	  otherwise T5W pinctrl can't work

config AMLOGIC_PINCTRL_MESON_T3X
	tristate "Meson T3X Soc pinctrl driver"
	default n
	help
	  the chip of T3X will be built
	  when enable this config.
	  T3X pinctrl can work.
	  otherwise T3X pinctrl can't work

config AMLOGIC_PINCTRL_MESON_TXHD2
	tristate "Meson TXHD2 Soc pinctrl driver"
	default n
	help
	  the chip of TXHD2 will be built
	  when enable this config.
	  TXHD2 pinctrl can work.
	  otherwise TXHD2 pinctrl can't work

config AMLOGIC_PINCTRL_MESON_C1
	tristate "Meson C1 Soc pinctrl driver"
	default n
	help
	  the chip of C1 will be built
	  when enable this config.
	  C1 pinctrl can work.
	  otherwise C1 pinctrl can't work

config AMLOGIC_PINCTRL_MESON_S1A
	tristate "Meson S1A Soc pinctrl driver"
	default n
	help
	  the chip of S1A will be built
	  when enable this config.
	  S1A pinctrl can work.
	  otherwise S1A pinctrl can't work

config AMLOGIC_PINCTRL_MESON_T5D
	tristate "Meson T5D Soc pinctrl driver"
	default n
	help
	  the chip of T5D will be built
	  when enable this config.
	  T5D pinctrl can work.
	  otherwise T5D pinctrl can't work
endif
```

## drivers/host/Kconfig
```kconfig
# SPDX-License-Identifier: (GPL-2.0+ OR MIT)

# amlogic mcu host driver  configuration

config AMLOGIC_HOST_DRIVER
	tristate "mcu host driver control support"
	default n
	help
		This is the Amlogic
		kernel load mcu driver
		support the amlogic mcu host driver;
```

## drivers/hwspinlock/Kconfig
```kconfig
#
# Amlogic hwspinlock device configuration
#

menu "MESON hw spin lock Support"

config AMLOGIC_HWSPINLOCK
	tristate "MESON HW SPIN LOCK"
	select HWSPINLOCK
	help
		MESON HWSPIN LOCK.
		.
		.
		.

endmenu
```

## drivers/i2c/Kconfig
```kconfig
# SPDX-License-Identifier: (GPL-2.0+ OR MIT)

source "$(COMMON_DRIVERS_DIR)/drivers/i2c/busses/Kconfig"
```
