## Kconfig.ext
```kconfig
# SPDX-License-Identifier: GPL-2.0

source "$(KCONFIG_EXT_PREFIX)project/Kconfig.ext_modules"
```

## arch/arm/configs/C3_debug_defconfig
```kconfig
#
# USB ADB Support
#
CONFIG_USB=y
CONFIG_USB_SUPPORT=y
CONFIG_USB_OTG=y
CONFIG_USB_XHCI_HCD=y
CONFIG_USB_GADGET=y
CONFIG_USB_CONFIGFS=y
CONFIG_USB_CONFIGFS_UEVENT=y
CONFIG_USB_CONFIGFS_F_FS=y
CONFIG_AMLOGIC_USB=y
CONFIG_AMLOGIC_COMMON_USB=y
CONFIG_AMLOGIC_USB_SUPPORT=m
CONFIG_AMLOGIC_USB_DWC_OTG_HCD=y
CONFIG_AMLOGIC_CRG=y
CONFIG_AMLOGIC_USBPHY=y
CONFIG_AMLOGIC_USB2PHY=y
CONFIG_AMLOGIC_USB3PHY=y
CONFIG_AMLOGIC_USBPHYC2=y
```

## arch/arm/configs/amlogic_gcc32_defconfig
```kconfig
# CONFIG_GCC_PLUGINS is not set
CONFIG_AMLOGIC_SERIAL_MESON=y
CONFIG_AMLOGIC_MEDIA_V4L2=y
```

## arch/arm/configs/amlogic_upgrade_p.defconfig
```kconfig
# SPDX-License-Identifier: (GPL-2.0+ OR MIT)

# amlogic-uart
CONFIG_AMLOGIC_SERIAL_MESON=y

# amlogic-gkitool
CONFIG_AMLOGIC_GKI_TOOL=y

# amlogic-debug
CONFIG_AMLOGIC_DEBUG=y

# amlogic-debug-iotrace
CONFIG_AMLOGIC_DEBUG_IOTRACE=y

# amlogic-memory-debug
CONFIG_AMLOGIC_MEMORY_DEBUG=y

# amlogic-secmon
CONFIG_AMLOGIC_SECMON=y

# amlogic-clk
CONFIG_AMLOGIC_COMMON_CLK=y

# amlogic-clk-soc-xxx
CONFIG_AMLOGIC_COMMON_CLK_C2=y
CONFIG_AMLOGIC_COMMON_CLK_C3=y
CONFIG_AMLOGIC_COMMON_CLK_A1=y
CONFIG_AMLOGIC_COMMON_CLK_S4=y
CONFIG_AMLOGIC_COMMON_CLK_SC2=y
CONFIG_AMLOGIC_COMMON_CLK_T3=y
CONFIG_AMLOGIC_COMMON_CLK_T7=y
CONFIG_AMLOGIC_COMMON_CLK_T5M=y
CONFIG_AMLOGIC_COMMON_CLK_T5W=y
CONFIG_AMLOGIC_COMMON_AO_CLK_T5W=y
CONFIG_AMLOGIC_COMMON_CLK_TXHD2=y
CONFIG_AMLOGIC_COMMON_AO_CLK_TXHD2=y

# amlogic-gpio
CONFIG_AMLOGIC_GPIO=y

# amlogic-pinctrl-soc-xxx
CONFIG_AMLOGIC_PINCTRL_MESON_C2=y
CONFIG_AMLOGIC_PINCTRL_MESON_C3=y
CONFIG_AMLOGIC_PINCTRL_MESON_A1=y
CONFIG_AMLOGIC_PINCTRL_MESON_TXHD2=y
CONFIG_AMLOGIC_PINCTRL_MESON_S4=y
CONFIG_AMLOGIC_PINCTRL_MESON_SC2=y
CONFIG_AMLOGIC_PINCTRL_MESON_T3=y
CONFIG_AMLOGIC_PINCTRL_MESON_T7=y
CONFIG_AMLOGIC_PINCTRL_MESON_T5M=y
CONFIG_AMLOGIC_PINCTRL_MESON_T5W=y

# amlogic-mailbox
CONFIG_AMLOGIC_MHU_MBOX=y

# amlogic-pwm
CONFIG_AMLOGIC_PWM=y
CONFIG_AMLOGIC_PWM_MESON=y
CONFIG_AMLOGIC_PWM_MESON_TEE=y

# pwm-regulator
CONFIG_REGULATOR_PWM=y
CONFIG_AMLOGIC_PWM_REGULATOR=y

# amlogic-power
CONFIG_AMLOGIC_POWER=y

# amlogic-cpuinfo
CONFIG_AMLOGIC_CPU_INFO=y

# amlogic-cpufreq
CONFIG_AMLOGIC_MESON_CPUFREQ=y

# amlogic-reset
CONFIG_AMLOGIC_RESET_MESON=y
CONFIG_AMLOGIC_DOS_RESET_MESON=y

# amlogic-efuse-unifykey
CONFIG_AMLOGIC_EFUSE_UNIFYKEY=y

# amlogic-mmc
CONFIG_AMLOGIC_MMC_MESON_GX=y

# system_heap
CONFIG_DMABUF_HEAPS_SYSTEM=y

# amlogic-i2c
CONFIG_AMLOGIC_I2C_MESON=y

# amlogic-spi
CONFIG_AMLOGIC_SPI=y

# amlogic-rng
CONFIG_AMLOGIC_HW_RANDOM_MESON=y

# amlogic-tee
CONFIG_AMLOGIC_TEE=y

CONFIG_AMLOGIC_AMLTEE=y
CONFIG_AMLOGIC_OPTEE=y

# videobuf-core
CONFIG_AMLOGIC_MEDIA_UTILS=y

# dvb-core
CONFIG_DVB_CORE=y

# amlogic-pm
CONFIG_AMLOGIC_PM=y

# amlogic-input
CONFIG_AMLOGIC_INPUT=y

# amlogic-watchdog
CONFIG_AMLOGIC_MESON_GXBB_WATCHDOG=y

# amlogic-dvb
CONFIG_AMLOGIC_DVB_DMX=n
CONFIG_AMLOGIC_HW_DEMUX=m
CONFIG_AMLOGIC_DVB_CONFIG=y

# amlogic-dvb-ci
# CONFIG_AMLOGIC_DVB_CI=y

# aml_media
CONFIG_AMLOGIC_MEDIA_MODULE=y
CONFIG_FB=y
CONFIG_AMLOGIC_MEDIA_FB=y
CONFIG_AMLOGIC_MEDIA_FB_OSD_SYNC_FENCE=y
CONFIG_AMLOGIC_MEDIA_FB_OSD_VSYNC_RDMA=y
CONFIG_AMLOGIC_MEDIA_FB_OSD2_ENABLE=y
CONFIG_AMLOGIC_MEDIA_FB_OSD2_CURSOR=y

# amlogic-hwspinlock.ko
CONFIG_AMLOGIC_HWSPINLOCK=y

# amlogic-camera.ko
CONFIG_AMLOGIC_VIDEO_CAPTURE=y
CONFIG_AMLOGIC_VM_DISABLE_VIDEOLAYER=y
CONFIG_AMLOGIC_VIDEO_CAPTURE_OV5640=y

# amlogic-adc.ko
CONFIG_AMLOGIC_MESON_SARADC=y

# amlogic-thermal.ko
CONFIG_AMLOGIC_AMLOGIC_THERMAL=y

# amlogic-usb ko
CONFIG_AMLOGIC_USB_SUPPORT=y

# amlogic-irblaster.ko
CONFIG_AMLOGIC_IRBLASTER=y

# etherent
CONFIG_STMMAC_ETH=y
CONFIG_DWMAC_MESON=y
CONFIG_DWMAC_DWC_QOS_ETH=y
CONFIG_AMLOGIC_MDIO_G12A=y
CONFIG_AMLOGIC_INPHY=y
CONFIG_AMLOGIC_ETH_PRIVE=y

# aml_drm.ko
CONFIG_AMLOGIC_DRM=y

#sdcardfs
CONFIG_SDCARD_FS=y

# ntfs
CONFIG_NTFS_FS=y
CONFIG_NTFS_RW=y

# android P need
# CONFIG_ANDROID_BINDERFS is not set
CONFIG_ANDROID_LOW_MEMORY_KILLER=y
CONFIG_AMLOGIC_LMK=y

# boot optimize
CONFIG_AMLOGIC_BOOT_TIME=y

# amlogic-media
CONFIG_AMLOGIC_MEDIA_V4L2=y
```

## arch/arm/configs/amlogic_upgrade_r.defconfig
```kconfig
# SPDX-License-Identifier: (GPL-2.0+ OR MIT)

# amlogic-uart
CONFIG_AMLOGIC_SERIAL_MESON=y

# amlogic-gkitool
CONFIG_AMLOGIC_GKI_TOOL=y

# amlogic-debug
CONFIG_AMLOGIC_DEBUG=y

# amlogic-debug-iotrace
CONFIG_AMLOGIC_DEBUG_IOTRACE=y

# amlogic-memory-debug
CONFIG_AMLOGIC_MEMORY_DEBUG=y

# amlogic-secmon
CONFIG_AMLOGIC_SECMON=y

# amlogic-clk
CONFIG_AMLOGIC_COMMON_CLK=y

# amlogic-clk-soc-xxx
CONFIG_AMLOGIC_COMMON_CLK_C2=y
CONFIG_AMLOGIC_COMMON_CLK_C3=y
CONFIG_AMLOGIC_COMMON_CLK_A1=y
CONFIG_AMLOGIC_COMMON_CLK_S4=y
CONFIG_AMLOGIC_COMMON_CLK_SC2=y
CONFIG_AMLOGIC_COMMON_CLK_T3=y
CONFIG_AMLOGIC_COMMON_CLK_T7=y
CONFIG_AMLOGIC_COMMON_CLK_T5M=y
CONFIG_AMLOGIC_COMMON_CLK_T5W=y
CONFIG_AMLOGIC_COMMON_AO_CLK_T5W=y
CONFIG_AMLOGIC_COMMON_CLK_TXHD2=y
CONFIG_AMLOGIC_COMMON_AO_CLK_TXHD2=y

# amlogic-gpio
CONFIG_AMLOGIC_GPIO=y

# amlogic-pinctrl-soc-xxx
CONFIG_AMLOGIC_PINCTRL_MESON_C2=y
CONFIG_AMLOGIC_PINCTRL_MESON_C3=y
CONFIG_AMLOGIC_PINCTRL_MESON_A1=y
CONFIG_AMLOGIC_PINCTRL_MESON_TXHD2=y
CONFIG_AMLOGIC_PINCTRL_MESON_S4=y
CONFIG_AMLOGIC_PINCTRL_MESON_SC2=y
CONFIG_AMLOGIC_PINCTRL_MESON_T3=y
CONFIG_AMLOGIC_PINCTRL_MESON_T7=y
CONFIG_AMLOGIC_PINCTRL_MESON_T5M=y
CONFIG_AMLOGIC_PINCTRL_MESON_T5W=y

# amlogic-mailbox
CONFIG_AMLOGIC_MHU_MBOX=y

# amlogic-pwm
CONFIG_AMLOGIC_PWM=y
CONFIG_AMLOGIC_PWM_MESON=y
CONFIG_AMLOGIC_PWM_MESON_TEE=y

# pwm-regulator
CONFIG_REGULATOR_PWM=y
CONFIG_AMLOGIC_PWM_REGULATOR=y

# amlogic-power
CONFIG_AMLOGIC_POWER=y

# amlogic-cpuinfo
CONFIG_AMLOGIC_CPU_INFO=y

# amlogic-cpufreq
CONFIG_AMLOGIC_MESON_CPUFREQ=y

# amlogic-reset
CONFIG_AMLOGIC_RESET_MESON=y
CONFIG_AMLOGIC_DOS_RESET_MESON=y

# amlogic-efuse-unifykey
CONFIG_AMLOGIC_EFUSE_UNIFYKEY=y

# amlogic-mmc
CONFIG_AMLOGIC_MMC_MESON_GX=y

# system_heap
CONFIG_DMABUF_HEAPS_SYSTEM=y

# amlogic-i2c
CONFIG_AMLOGIC_I2C_MESON=y

# amlogic-spi
CONFIG_AMLOGIC_SPI=y

# amlogic-rng
CONFIG_AMLOGIC_HW_RANDOM_MESON=y

# amlogic-tee
CONFIG_AMLOGIC_AMLTEE=y
CONFIG_AMLOGIC_OPTEE=y
CONFIG_AMLOGIC_TEE=y

# videobuf-core
CONFIG_AMLOGIC_MEDIA_UTILS=y

# dvb-core
CONFIG_DVB_CORE=y

# amlogic-pm
CONFIG_AMLOGIC_PM=y

# amlogic-input
CONFIG_AMLOGIC_INPUT=y

# amlogic-watchdog
CONFIG_AMLOGIC_MESON_GXBB_WATCHDOG=y

# amlogic-dvb
CONFIG_AMLOGIC_DVB_CONFIG=y

# amlogic-dvb-ci
# CONFIG_AMLOGIC_DVB_CI=y

# aml_media
CONFIG_AMLOGIC_MEDIA_MODULE=y
CONFIG_FB=y
CONFIG_AMLOGIC_MEDIA_FB=y
CONFIG_AMLOGIC_MEDIA_FB_OSD_SYNC_FENCE=y
CONFIG_AMLOGIC_MEDIA_FB_OSD_VSYNC_RDMA=y
CONFIG_AMLOGIC_MEDIA_FB_OSD2_ENABLE=y
CONFIG_AMLOGIC_MEDIA_FB_OSD2_CURSOR=y

# vts
CONFIG_AMLOGIC_BGKI_SCHED_SYSCTL=y

# boot optimize
CONFIG_AMLOGIC_BOOT_TIME=y

# amlogic-media
CONFIG_AMLOGIC_MEDIA_V4L2=y
```

## arch/arm/configs/meson64_a32_C3_mini_defconfig
```kconfig
# CONFIG_LOCALVERSION_AUTO is not set
CONFIG_KERNEL_LZMA=y
CONFIG_SYSVIPC=y
CONFIG_NO_HZ=y
CONFIG_HIGH_RES_TIMERS=y
CONFIG_PREEMPT=y
CONFIG_BLK_DEV_INITRD=y
# CONFIG_RD_BZIP2 is not set
# CONFIG_RD_LZMA is not set
# CONFIG_RD_XZ is not set
# CONFIG_RD_LZO is not set
# CONFIG_RD_LZ4 is not set
# CONFIG_RD_ZSTD is not set
CONFIG_EXPERT=y
# CONFIG_BUG is not set
# CONFIG_KALLSYMS is not set
# CONFIG_SLUB_DEBUG is not set
# CONFIG_COMPAT_BRK is not set
CONFIG_AMLOGIC_LINUX_S_OPTIMIZE=y
CONFIG_ARCH_VIRT=y
CONFIG_ARM_THUMBEE=y
# CONFIG_KUSER_HELPERS is not set
# CONFIG_CACHE_L2X0 is not set
# CONFIG_ARM_ERRATA_643719 is not set
CONFIG_SMP=y
# CONFIG_SMP_ON_UP is not set
CONFIG_NR_CPUS=2
CONFIG_HOTPLUG_CPU=y
CONFIG_HZ_250=y
CONFIG_HIGHMEM=y
# CONFIG_ATAGS is not set
CONFIG_CPU_FREQ=y
CONFIG_CPU_FREQ_STAT=y
CONFIG_CPU_IDLE=y
CONFIG_ARM_CPUIDLE=y
CONFIG_ARM_PSCI_CPUIDLE=y
CONFIG_VFP=y
CONFIG_NEON=y
# CONFIG_SUSPEND is not set
CONFIG_PM=y
# CONFIG_SECCOMP is not set
# CONFIG_STACKPROTECTOR is not set
# CONFIG_STRICT_KERNEL_RWX is not set
# CONFIG_GCC_PLUGINS is not set
CONFIG_MODULES=y
CONFIG_MODULE_UNLOAD=y
CONFIG_PARTITION_ADVANCED=y
# CONFIG_MQ_IOSCHED_KYBER is not set
# CONFIG_COREDUMP is not set
CONFIG_DEFAULT_MMAP_MIN_ADDR=32768
CONFIG_CMA=y
CONFIG_NET=y
CONFIG_PACKET=y
CONFIG_UNIX=y
CONFIG_INET=y
CONFIG_IP_PNP=y
CONFIG_IP_PNP_DHCP=y
CONFIG_IPV6=m
CONFIG_BT=m
CONFIG_CFG80211=m
CONFIG_MAC80211=m
CONFIG_RFKILL=m
# CONFIG_ETHTOOL_NETLINK is not set
CONFIG_DEVTMPFS=y
CONFIG_DEVTMPFS_MOUNT=y
# CONFIG_ALLOW_DEV_COREDUMP is not set
CONFIG_MTD=y
CONFIG_MTD_BLOCK=y
CONFIG_MTD_RAW_NAND=y
CONFIG_MTD_UBI=y
CONFIG_BLK_DEV_RAM=y
CONFIG_BLK_DEV_RAM_SIZE=8192
CONFIG_SCSI=y
CONFIG_NETDEVICES=y
# CONFIG_NET_VENDOR_ALACRITECH is not set
# CONFIG_NET_VENDOR_AMAZON is not set
# CONFIG_NET_VENDOR_AQUANTIA is not set
# CONFIG_NET_VENDOR_ARC is not set
# CONFIG_NET_VENDOR_BROADCOM is not set
# CONFIG_NET_VENDOR_CADENCE is not set
# CONFIG_NET_VENDOR_CAVIUM is not set
# CONFIG_NET_VENDOR_CIRRUS is not set
# CONFIG_NET_VENDOR_CORTINA is not set
# CONFIG_NET_VENDOR_EZCHIP is not set
# CONFIG_NET_VENDOR_FARADAY is not set
# CONFIG_NET_VENDOR_GOOGLE is not set
# CONFIG_NET_VENDOR_HISILICON is not set
# CONFIG_NET_VENDOR_HUAWEI is not set
# CONFIG_NET_VENDOR_INTEL is not set
# CONFIG_NET_VENDOR_LITEX is not set
# CONFIG_NET_VENDOR_MARVELL is not set
# CONFIG_NET_VENDOR_MELLANOX is not set
# CONFIG_NET_VENDOR_MICREL is not set
# CONFIG_NET_VENDOR_MICROCHIP is not set
# CONFIG_NET_VENDOR_MICROSEMI is not set
# CONFIG_NET_VENDOR_MICROSOFT is not set
# CONFIG_NET_VENDOR_NI is not set
# CONFIG_NET_VENDOR_NATSEMI is not set
# CONFIG_NET_VENDOR_NETRONOME is not set
# CONFIG_NET_VENDOR_PENSANDO is not set
# CONFIG_NET_VENDOR_QUALCOMM is not set
# CONFIG_NET_VENDOR_RENESAS is not set
# CONFIG_NET_VENDOR_ROCKER is not set
# CONFIG_NET_VENDOR_SAMSUNG is not set
# CONFIG_NET_VENDOR_SEEQ is not set
# CONFIG_NET_VENDOR_SOLARFLARE is not set
# CONFIG_NET_VENDOR_SMSC is not set
# CONFIG_NET_VENDOR_SOCIONEXT is not set
CONFIG_STMMAC_ETH=m
CONFIG_DWMAC_DWC_QOS_ETH=m
# CONFIG_DWMAC_GENERIC is not set
CONFIG_DWMAC_MESON=m
CONFIG_AMLOGIC_ETH_PRIVE=m
# CONFIG_NET_VENDOR_SYNOPSYS is not set
# CONFIG_NET_VENDOR_VIA is not set
# CONFIG_NET_VENDOR_WIZNET is not set
# CONFIG_NET_VENDOR_XILINX is not set
CONFIG_PHYLIB=y
# CONFIG_WLAN is not set
CONFIG_INPUT_EVDEV=y
# CONFIG_INPUT_KEYBOARD is not set
# CONFIG_INPUT_MOUSE is not set
# CONFIG_SERIO_SERPORT is not set
# CONFIG_LEGACY_PTYS is not set
CONFIG_SERIAL_DEV_BUS=y
CONFIG_HW_RANDOM=y
CONFIG_I2C=y
CONFIG_I2C_CHARDEV=y
CONFIG_I2C_MUX=y
CONFIG_SPI=y
CONFIG_SPI_MEM=y
CONFIG_PINCTRL=y
CONFIG_PINCTRL_SINGLE=y
CONFIG_GPIOLIB=y
CONFIG_GPIOLIB_FASTPATH_LIMIT=128
CONFIG_GPIO_SYSFS=y
CONFIG_POWER_RESET=y
CONFIG_POWER_SUPPLY=y
# CONFIG_HWMON is not set
CONFIG_THERMAL=y
CONFIG_THERMAL_EMERGENCY_POWEROFF_DELAY_MS=200
CONFIG_THERMAL_WRITABLE_TRIPS=y
CONFIG_CPU_THERMAL=y
CONFIG_WATCHDOG=y
CONFIG_WATCHDOG_CORE=y
CONFIG_WATCHDOG_SYSFS=y
CONFIG_REGULATOR=y
CONFIG_REGULATOR_FIXED_VOLTAGE=y
CONFIG_REGULATOR_GPIO=y
CONFIG_REGULATOR_PWM=m
CONFIG_REGULATOR_VCTRL=y
CONFIG_FB=y
CONFIG_BACKLIGHT_CLASS_DEVICE=y
# CONFIG_HID is not set
# CONFIG_USB_SUPPORT is not set
CONFIG_MMC=y
# CONFIG_PWRSEQ_EMMC is not set
CONFIG_MMC_BLOCK_MINORS=16
CONFIG_RTC_CLASS=y
CONFIG_RTC_DRV_PCF8563=y
CONFIG_DMADEVICES=y
CONFIG_SYNC_FILE=y
CONFIG_DMABUF_HEAPS=y
CONFIG_DMABUF_SYSFS_STATS=y
CONFIG_DMABUF_HEAPS_DEFERRED_FREE=y
CONFIG_DMABUF_HEAPS_PAGE_POOL=y
CONFIG_DMABUF_HEAPS_SYSTEM=m
CONFIG_UIO=y
# CONFIG_VIRTIO_MENU is not set
# CONFIG_VHOST_MENU is not set
# CONFIG_IOMMU_SUPPORT is not set
CONFIG_PM_DEVFREQ=y
CONFIG_DEVFREQ_GOV_SIMPLE_ONDEMAND=y
CONFIG_PWM=y
# CONFIG_NVMEM_SYSFS is not set
CONFIG_AMLOGIC_DRIVER=y
CONFIG_AMLOGIC_BREAK_GKI_20=y
CONFIG_AMLOGIC_BREAK_GKI=y
CONFIG_AMLOGIC_MODIFY=y
CONFIG_AMLOGIC_IN_KERNEL_MODULES=y
CONFIG_AMLOGIC_SERIAL_MESON=y
CONFIG_AMLOGIC_SERIAL_EARLY_CONSOLE=y
CONFIG_AMLOGIC_SERIAL_MESON_CONSOLE=y
CONFIG_AMLOGIC_COMMON_CLK=y
CONFIG_AMLOGIC_COMMON_CLK_MESON_REGMAP=y
CONFIG_AMLOGIC_COMMON_CLK_MESON_DUALDIV=y
CONFIG_AMLOGIC_COMMON_CLK_MESON_MPLL=y
CONFIG_AMLOGIC_COMMON_CLK_MESON_PLL=y
CONFIG_AMLOGIC_COMMON_CLK_MESON_CPU_DYNDIV=y
CONFIG_AMLOGIC_MESON_CLK_MEASURE=y
CONFIG_AMLOGIC_COMMON_CLK_C3=y
CONFIG_AMLOGIC_SECMON=y
CONFIG_AMLOGIC_MEDIA_MODULE=m
CONFIG_AMLOGIC_MEDIA_ENABLE=y
CONFIG_AMLOGIC_MEDIA_COMMON=y
CONFIG_AMLOGIC_MEDIA_DRIVERS=y
CONFIG_AMLOGIC_MEDIA_CANVAS=y
CONFIG_AMLOGIC_ION_DEV=y
CONFIG_AMLOGIC_ION=y
CONFIG_AMLOGIC_ION_SYSTEM_HEAP=y
CONFIG_AMLOGIC_VPU=y
CONFIG_AMLOGIC_MEDIA_RDMA=y
CONFIG_AMLOGIC_MEDIA_VSYNC_RDMA=y
CONFIG_AMLOGIC_MEDIA_VFM=y
CONFIG_AMLOGIC_MEDIA_CODEC_MM=y
CONFIG_AMLOGIC_VOUT=y
CONFIG_AMLOGIC_VOUT_CLK_SERVE=y
CONFIG_AMLOGIC_VOUT_SERVE=y
CONFIG_AMLOGIC_LCD=y
CONFIG_AMLOGIC_LCD_TABLET=y
CONFIG_AMLOGIC_BACKLIGHT=y
CONFIG_AMLOGIC_BL_EXTERN=y
CONFIG_AMLOGIC_LCD_EXTERN=y
CONFIG_AMLOGIC_MEDIA_VIDEO=y
CONFIG_AMLOGIC_MEDIA_FB=y
CONFIG_AMLOGIC_MEDIA_FB_OSD_VSYNC_RDMA=y
CONFIG_AMLOGIC_MEDIA_FB_OSD2_ENABLE=y
CONFIG_AMLOGIC_MEDIA_FB_OSD2_CURSOR=y
CONFIG_AMLOGIC_MEDIA_VIDEO_PROCESSOR=y
CONFIG_AMLOGIC_VIDEO_COMPOSER=y
CONFIG_AMLOGIC_POWER=y
CONFIG_AMLOGIC_CPU_INFO=m
CONFIG_AMLOGIC_SHOW_CPU_CHIPID=y
CONFIG_AMLOGIC_PM=m
CONFIG_AMLOGIC_GX_REBOOT=y
CONFIG_AMLOGIC_GPIO=m
CONFIG_AMLOGIC_GPIOLIB=y
CONFIG_AMLOGIC_MESON_IRQ_GPIO=y
CONFIG_AMLOGIC_PINCTRL_MESON=y
CONFIG_AMLOGIC_PINCTRL_MESON_C3=m
CONFIG_AMLOGIC_I2C_MESON=m
CONFIG_AMLOGIC_SPI=m
CONFIG_AMLOGIC_SPI_MESON_SPICC=m
CONFIG_AMLOGIC_SPI_MESON_SPIFC_V2=m
CONFIG_AMLOGIC_GKI_TOOL=y
CONFIG_AMLOGIC_PWM_MESON=m
CONFIG_AMLOGIC_MESON_CPUFREQ=m
CONFIG_AMLOGIC_EFUSE_UNIFYKEY=m
CONFIG_AMLOGIC_EFUSE=y
CONFIG_AMLOGIC_UNIFYKEY=y
CONFIG_AMLOGIC_EFUSE_BURN=y
CONFIG_AMLOGIC_ARM_SMC_WATCHDOG=y
CONFIG_AMLOGIC_MEMORY_EXTEND=y
CONFIG_AMLOGIC_SLAB_TRACE=y
CONFIG_AMLOGIC_CMA=y
CONFIG_AMLOGIC_MEM_DEBUG=y
CONFIG_AMLOGIC_STACKPROTECTOR=y
CONFIG_AMLOGIC_USER_FAULT=y
CONFIG_AMLOGIC_MEMORY_DEBUG=m
CONFIG_AMLOGIC_REG_ACCESS=y
CONFIG_AMLOGIC_HW_RANDOM_MESON=m
CONFIG_AMLOGIC_RESET_MESON=y
CONFIG_AMLOGIC_AMLOGIC_THERMAL=m
CONFIG_AMLOGIC_COOLDEV=y
CONFIG_AMLOGIC_CPUCORE_THERMAL=y
CONFIG_AMLOGIC_DDR_THERMAL=y
CONFIG_AMLOGIC_MMC_MESON_GX=m
CONFIG_AMLOGIC_DEBUG=y
CONFIG_AMLOGIC_BGKI_DEBUG_MISC=y
CONFIG_AMLOGIC_DEBUG_ATRACE=y
CONFIG_AMLOGIC_BOOT_TIME=y
CONFIG_AMLOGIC_DEBUG_HLD=y
CONFIG_AMLOGIC_FREERTOS=y
CONFIG_AMLOGIC_AUTO_CAPTURE=y
CONFIG_AMLOGIC_CRYPTO_DMA=m
CONFIG_AMLOGIC_WIRELESS=m
CONFIG_AMLOGIC_BLUETOOTH=y
CONFIG_AMLOGIC_WIFI=y
CONFIG_AMLOGIC_MDIO_G12A=m
CONFIG_AMLOGIC_INPHY=m
CONFIG_AMLOGIC_MTD_SPI_NAND=m
CONFIG_AMLOGIC_MTD_NAND=m
CONFIG_AMLOGIC_MTD_COMMON=m
CONFIG_AMLOGIC_MTD_RESV=m
# CONFIG_DNOTIFY is not set
CONFIG_MSDOS_FS=m
CONFIG_NTFS3_FS=m
CONFIG_TMPFS=y
CONFIG_TMPFS_POSIX_ACL=y
CONFIG_UBIFS_FS=y
CONFIG_UBIFS_FS_ADVANCED_COMPR=y
# CONFIG_UBIFS_FS_ZLIB is not set
# CONFIG_UBIFS_FS_ZSTD is not set
# CONFIG_NETWORK_FILESYSTEMS is not set
CONFIG_NLS_CODEPAGE_437=m
CONFIG_NLS_ISO8859_1=m
CONFIG_CRYPTO_DES=m
CONFIG_CRYPTO_USER_API_SKCIPHER=m
# CONFIG_CRYPTO_HW is not set
CONFIG_DMA_CMA=y
CONFIG_CMA_SIZE_MBYTES=8
CONFIG_CMA_ALIGNMENT=4
CONFIG_PRINTK_TIME=y
CONFIG_DEBUG_INFO=y
CONFIG_FRAME_WARN=2048
CONFIG_DEBUG_SECTION_MISMATCH=y
# CONFIG_SECTION_MISMATCH_WARN_ONLY is not set
CONFIG_PANIC_ON_OOPS=y
CONFIG_PANIC_TIMEOUT=5
CONFIG_SOFTLOCKUP_DETECTOR=y
CONFIG_BOOTPARAM_SOFTLOCKUP_PANIC=y
CONFIG_STACKTRACE=y
# CONFIG_RCU_TRACE is not set
# CONFIG_RUNTIME_TESTING_MENU is not set
```
